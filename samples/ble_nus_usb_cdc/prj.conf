## prj.conf
```kconfig
#
# Copyright (c) 2018 Nordic Semiconductor
#
# SPDX-License-Identifier: LicenseRef-Nordic-5-Clause
#

# Enable the UART driver
CONFIG_UART_ASYNC_API=y
CONFIG_NRFX_UARTE0=y
CONFIG_SERIAL=y
CONFIG_CONSOLE=y
CONFIG_UART_CONSOLE=n

# Enable RTT for console output
CONFIG_USE_SEGGER_RTT=y
CONFIG_RTT_CONSOLE=y

# Enable USB CDC ACM for screen communication
CONFIG_USB_DEVICE_STACK=y
CONFIG_USB_CDC_ACM=y
CONFIG_USB_CDC_ACM_RINGBUF_SIZE=4096
CONFIG_USB_DEVICE_INITIALIZE_AT_BOOT=y
CONFIG_USB_DEVICE_PRODUCT="MouthPad^USB"
CONFIG_USB_DEVICE_MANUFACTURER="Augmental Tech"
CONFIG_USB_DEVICE_SN="12345678901234567890"
CONFIG_USB_DEVICE_PID=0xEEEE
CONFIG_USB_DEVICE_VID=0x1915

# Enable the BLE stack with GATT Client configuration
CONFIG_BT=y
CONFIG_BT_CENTRAL=y
CONFIG_BT_SMP=y
CONFIG_BT_GATT_CLIENT=y

# Enable larger MTU for BLE NUS
CONFIG_BT_L2CAP_TX_MTU=247
CONFIG_BT_BUF_ACL_RX_SIZE=247
CONFIG_BT_BUF_ACL_TX_SIZE=247

# Explicitly disable SC-only mode to allow legacy pairing
CONFIG_BT_SMP_SC_PAIR_ONLY=n

# Enable the BLE modules from NCS
CONFIG_BT_NUS_CLIENT=y
CONFIG_BT_SCAN=y
CONFIG_BT_SCAN_FILTER_ENABLE=y
CONFIG_BT_SCAN_UUID_CNT=1
CONFIG_BT_SCAN_ADDRESS_CNT=1
CONFIG_BT_GATT_DM=y
CONFIG_HEAP_MEM_POOL_SIZE=2048

# This example requires more stack
CONFIG_SYSTEM_WORKQUEUE_STACK_SIZE=2048
# Enable bonding
CONFIG_BT_SETTINGS=y
CONFIG_FLASH=y
CONFIG_FLASH_PAGE_LAYOUT=y
CONFIG_FLASH_MAP=y

# Config logger
CONFIG_LOG=y
CONFIG_LOG_BACKEND_RTT=y
CONFIG_LOG_BACKEND_UART=n

CONFIG_ASSERT=y
```

## src/ble_central.c
```c
/*
 * Copyright (c) 2025 Robert Dale Smith
 * Copyright (c) 2025 Augmental Tech
 *
 * SPDX-License-Identifier: Apache-2.0
 */

#include "ble_central.h"
#include <zephyr/kernel.h>
#include <zephyr/bluetooth/bluetooth.h>
#include <zephyr/bluetooth/hci.h>
#include <zephyr/bluetooth/conn.h>
#include <zephyr/bluetooth/uuid.h>
#include <zephyr/bluetooth/gatt.h>
#include <bluetooth/gatt_dm.h>
#include <bluetooth/scan.h>
#include <bluetooth/services/nus.h>
#include <zephyr/settings/settings.h>
#include <zephyr/logging/log.h>
#include <zephyr/sys/printk.h>
#include <dk_buttons_and_leds.h>

LOG_MODULE_REGISTER(ble_central, LOG_LEVEL_INF);

/* Button definitions for pairing */
#define KEY_PAIRING_ACCEPT DK_BTN1_MSK
#define KEY_PAIRING_REJECT DK_BTN2_MSK

/* BLE Central state */
static struct bt_conn *default_conn;
static struct k_work scan_work;

/* Callback functions for external modules */
static ble_central_connected_cb_t connected_cb;
static ble_central_disconnected_cb_t disconnected_cb;
static ble_central_security_changed_cb_t security_changed_cb;

/* BLE Central callbacks */
static void connected(struct bt_conn *conn, uint8_t conn_err);
static void disconnected(struct bt_conn *conn, uint8_t reason);
static void security_changed(struct bt_conn *conn, bt_security_t level, enum bt_security_err err);

/* Scan callbacks */
static void scan_filter_match(struct bt_scan_device_info *device_info,
			      struct bt_scan_filter_match *filter_match,
			      bool connectable);
static void scan_connecting_error(struct bt_scan_device_info *device_info);
static void scan_connecting(struct bt_scan_device_info *device_info,
			    struct bt_conn *conn);

/* Authentication callbacks */
static void auth_cancel(struct bt_conn *conn);
static void pairing_complete(struct bt_conn *conn, bool bonded);
static void pairing_failed(struct bt_conn *conn, enum bt_security_err reason);

/* Connection callbacks structure */
BT_CONN_CB_DEFINE(conn_callbacks) = {
	.connected = connected,
	.disconnected = disconnected,
	.security_changed = security_changed
};

/* Scan callbacks structure */
BT_SCAN_CB_INIT(scan_cb, scan_filter_match, NULL,
		scan_connecting_error, scan_connecting);

/* Authentication callbacks - will be defined after function implementations */
static struct bt_conn_auth_cb conn_auth_callbacks;
static struct bt_conn_auth_info_cb conn_auth_info_callbacks;

/* Connection callback implementations */
static void connected(struct bt_conn *conn, uint8_t conn_err)
{
	char addr[BT_ADDR_LE_STR_LEN];
	int err;

	bt_addr_le_to_str(bt_conn_get_dst(conn), addr, sizeof(addr));

	if (conn_err) {
		printk("*** CONNECTION FAILED: %s, error: 0x%02x ***\n", addr, conn_err);
		LOG_INF("Failed to connect to %s, 0x%02x %s", addr, conn_err,
			bt_hci_err_to_str(conn_err));

		if (default_conn == conn) {
			bt_conn_unref(default_conn);
			default_conn = NULL;

			(void)k_work_submit(&scan_work);
		}

		return;
	}

	printk("*** CONNECTED TO DEVICE: %s ***\n", addr);
	LOG_INF("Connected: %s", addr);

	/* Call external connected callback if registered */
	if (connected_cb) {
		connected_cb(conn);
	}

	err = bt_scan_stop();
	if ((!err) && (err != -EALREADY)) {
		LOG_ERR("Stop LE scan failed (err %d)", err);
	}
}

static void disconnected(struct bt_conn *conn, uint8_t reason)
{
	char addr[BT_ADDR_LE_STR_LEN];

	bt_addr_le_to_str(bt_conn_get_dst(conn), addr, sizeof(addr));

	printk("*** DISCONNECTED FROM DEVICE: %s, reason: 0x%02x ***\n", addr, reason);
	LOG_INF("Disconnected: %s, reason 0x%02x %s", addr, reason, bt_hci_err_to_str(reason));

	if (default_conn != conn) {
		return;
	}

	bt_conn_unref(default_conn);
	default_conn = NULL;

	/* Call external disconnected callback if registered */
	if (disconnected_cb) {
		disconnected_cb(conn, reason);
	}

	printk("*** RESTARTING SCAN AFTER DISCONNECTION ***\n");
	(void)k_work_submit(&scan_work);
}

static void security_changed(struct bt_conn *conn, bt_security_t level,
			     enum bt_security_err err)
{
	char addr[BT_ADDR_LE_STR_LEN];

	bt_addr_le_to_str(bt_conn_get_dst(conn), addr, sizeof(addr));

	if (!err) {
		LOG_INF("Security changed: %s level %u", addr, level);
	} else {
		LOG_WRN("Security failed: %s level %u err %d %s", addr, level, err,
			bt_security_err_to_str(err));
	}

	/* Call external security changed callback if registered */
	if (security_changed_cb) {
		security_changed_cb(conn, level, err);
	}
}

/* Scan callback implementations */
static void scan_filter_match(struct bt_scan_device_info *device_info,
			      struct bt_scan_filter_match *filter_match,
			      bool connectable)
{
	char addr[BT_ADDR_LE_STR_LEN];

	bt_addr_le_to_str(device_info->recv_info->addr, addr, sizeof(addr));

	printk("*** DEVICE FOUND WITH NUS: %s connectable: %d ***\n", addr, connectable);
	LOG_INF("Filters matched. Address: %s connectable: %d",
		addr, connectable);
	
	// Log additional device info for debugging
	LOG_INF("RSSI: %d", device_info->recv_info->rssi);
}

static void scan_connecting_error(struct bt_scan_device_info *device_info)
{
	char addr[BT_ADDR_LE_STR_LEN];
	bt_addr_le_to_str(device_info->recv_info->addr, addr, sizeof(addr));
	printk("*** SCAN CONNECTING ERROR: %s ***\n", addr);
	LOG_WRN("Connecting failed");
}

static void scan_connecting(struct bt_scan_device_info *device_info,
			    struct bt_conn *conn)
{
	char addr[BT_ADDR_LE_STR_LEN];
	bt_addr_le_to_str(device_info->recv_info->addr, addr, sizeof(addr));
	printk("*** SCAN CONNECTING: %s ***\n", addr);
	default_conn = bt_conn_ref(conn);
}

/* Authentication callback implementations */
static void auth_passkey_display(struct bt_conn *conn, unsigned int passkey);
static void auth_passkey_confirm(struct bt_conn *conn, unsigned int passkey);
static void auth_cancel(struct bt_conn *conn);

static void auth_passkey_display(struct bt_conn *conn, unsigned int passkey)
{
	char addr[BT_ADDR_LE_STR_LEN];

	bt_addr_le_to_str(bt_conn_get_dst(conn), addr, sizeof(addr));

	printk("Passkey for %s: %06u\n", addr, passkey);
}

static void auth_passkey_confirm(struct bt_conn *conn, unsigned int passkey)
{
	char addr[BT_ADDR_LE_STR_LEN];

	ble_central_set_auth_conn(bt_conn_ref(conn));

	bt_addr_le_to_str(bt_conn_get_dst(conn), addr, sizeof(addr));

	printk("Passkey for %s: %06u\n", addr, passkey);
	printk("Press Button 1 to confirm, Button 2 to reject.\n");
}

static void auth_cancel(struct bt_conn *conn)
{
	char addr[BT_ADDR_LE_STR_LEN];

	bt_addr_le_to_str(bt_conn_get_dst(conn), addr, sizeof(addr));

	LOG_INF("Pairing cancelled: %s", addr);
}

/* Initialize authentication callback structures */
static void init_auth_callbacks(void)
{
	conn_auth_callbacks.passkey_display = auth_passkey_display;
	conn_auth_callbacks.passkey_confirm = auth_passkey_confirm;
	conn_auth_callbacks.cancel = auth_cancel;
	
	conn_auth_info_callbacks.pairing_complete = pairing_complete;
	conn_auth_info_callbacks.pairing_failed = pairing_failed;
}

static void pairing_complete(struct bt_conn *conn, bool bonded)
{
	char addr[BT_ADDR_LE_STR_LEN];

	bt_addr_le_to_str(bt_conn_get_dst(conn), addr, sizeof(addr));

	LOG_INF("Pairing completed: %s, bonded: %d", addr, bonded);
}

static void pairing_failed(struct bt_conn *conn, enum bt_security_err reason)
{
	char addr[BT_ADDR_LE_STR_LEN];

	bt_addr_le_to_str(bt_conn_get_dst(conn), addr, sizeof(addr));

	LOG_WRN("Pairing failed conn: %s, reason %d %s", addr, reason,
		bt_security_err_to_str(reason));
}

/* Authentication handling functions */
static struct bt_conn *auth_conn = NULL;

void ble_central_num_comp_reply(bool accept)
{
	if (accept) {
		bt_conn_auth_passkey_confirm(auth_conn);
		printk("Numeric Match, conn %p\n", auth_conn);
	} else {
		bt_conn_auth_cancel(auth_conn);
		printk("Numeric Reject, conn %p\n", auth_conn);
	}

	bt_conn_unref(auth_conn);
	auth_conn = NULL;
}

struct bt_conn *ble_central_get_auth_conn(void)
{
	return auth_conn;
}

void ble_central_set_auth_conn(struct bt_conn *conn)
{
	auth_conn = conn;
}

/* Address filter helper function */
static void try_add_address_filter(const struct bt_bond_info *info, void *user_data)
{
	int err;
	char addr[BT_ADDR_LE_STR_LEN];
	uint8_t *filter_mode = user_data;

	bt_addr_le_to_str(&info->addr, addr, sizeof(addr));

	struct bt_conn *conn = bt_conn_lookup_addr_le(BT_ID_DEFAULT, &info->addr);

	if (conn) {
		bt_conn_unref(conn);
		return;
	}

	err = bt_scan_filter_add(BT_SCAN_FILTER_TYPE_ADDR, &info->addr);
	if (err) {
		LOG_ERR("Address filter cannot be added (err %d): %s", err, addr);
		return;
	}

	LOG_INF("Address filter added: %s", addr);
	*filter_mode |= BT_SCAN_ADDR_FILTER;
}

/* Scan work handler */
static void scan_work_handler(struct k_work *item)
{
	ARG_UNUSED(item);
	(void)ble_central_start_scan();
}

/* Public API implementations */
int ble_central_init(void)
{
	int err;

	printk("Starting Bluetooth initialization...\n");
	err = bt_enable(NULL);
	if (err) {
		LOG_ERR("Bluetooth init failed (err %d)", err);
		return err;
	}
	LOG_INF("Bluetooth initialized");
	printk("Bluetooth initialized successfully\n");

	if (IS_ENABLED(CONFIG_SETTINGS)) {
		printk("Loading settings...\n");
		settings_load();
		printk("Settings loaded\n");
	}

	/* Authentication callbacks will be registered by ble_central_init_auth_callbacks() */

	/* Initialize scan */
	struct bt_scan_init_param scan_init = {
		.connect_if_match = true,
	};

	bt_scan_init(&scan_init);
	bt_scan_cb_register(&scan_cb);

	/* Initialize scan work */
	k_work_init(&scan_work, scan_work_handler);
	LOG_INF("Scan module initialized");

	return 0;
}

int ble_central_start_scan(void)
{
	int err;
	uint8_t filter_mode = 0;

	err = bt_scan_stop();
	if (err) {
		LOG_ERR("Failed to stop scanning (err %d)", err);
		return err;
	}

	bt_scan_filter_remove_all();

	err = bt_scan_filter_add(BT_SCAN_FILTER_TYPE_UUID, BT_UUID_NUS_SERVICE);
	if (err) {
		LOG_ERR("UUID filter cannot be added (err %d", err);
		return err;
	}
	filter_mode |= BT_SCAN_UUID_FILTER;

	bt_foreach_bond(BT_ID_DEFAULT, try_add_address_filter, &filter_mode);

	err = bt_scan_filter_enable(filter_mode, false);
	if (err) {
		LOG_ERR("Filters cannot be turned on (err %d)", err);
		return err;
	}

	err = bt_scan_start(BT_SCAN_TYPE_SCAN_ACTIVE);
	if (err) {
		LOG_ERR("Scanning failed to start (err %d)", err);
		return err;
	}

	LOG_INF("Scan started");
	return 0;
}

int ble_central_stop_scan(void)
{
	return bt_scan_stop();
}

struct bt_conn *ble_central_get_default_conn(void)
{
	return default_conn;
}

void ble_central_set_default_conn(struct bt_conn *conn)
{
	default_conn = conn;
}

void ble_central_register_connected_cb(ble_central_connected_cb_t cb)
{
	connected_cb = cb;
}

void ble_central_register_disconnected_cb(ble_central_disconnected_cb_t cb)
{
	disconnected_cb = cb;
}

void ble_central_register_security_changed_cb(ble_central_security_changed_cb_t cb)
{
	security_changed_cb = cb;
}

struct k_work *ble_central_get_scan_work(void)
{
	return &scan_work;
}

/* Button handling for authentication */
void ble_central_handle_buttons(uint32_t button_state, uint32_t has_changed)
{
	uint32_t button = button_state & has_changed;

	if (ble_central_get_auth_conn()) {
		if (button & KEY_PAIRING_ACCEPT) {
			ble_central_num_comp_reply(true);
		}

		if (button & KEY_PAIRING_REJECT) {
			ble_central_num_comp_reply(false);
		}

		return;
	}
}

/* Additional initialization functions like HID firmware */
int ble_central_init_callbacks(void)
{
	LOG_INF("BLE Central callbacks initialized");
	return 0;
}

int ble_central_init_auth_callbacks(void)
{
	int err;

	err = bt_conn_auth_cb_register(&conn_auth_callbacks);
	if (err) {
		LOG_ERR("Failed to register authorization callbacks (err %d)", err);
		return err;
	}

	err = bt_conn_auth_info_cb_register(&conn_auth_info_callbacks);
	if (err) {
		LOG_ERR("Failed to register authorization info callbacks (err %d)", err);
		return err;
	}

	LOG_INF("BLE Central auth callbacks initialized");
	return 0;
} 
```

## src/ble_central.h
```c
/*
 * Copyright (c) 2025 Robert Dale Smith
 * Copyright (c) 2025 Augmental Tech
 *
 * SPDX-License-Identifier: Apache-2.0
 */

#ifndef BLE_CENTRAL_H
#define BLE_CENTRAL_H

#include <zephyr/kernel.h>
#include <zephyr/bluetooth/bluetooth.h>
#include <zephyr/bluetooth/conn.h>
#include <bluetooth/scan.h>

/* BLE Central initialization and control functions */
int ble_central_init(void);
int ble_central_start_scan(void);
int ble_central_stop_scan(void);

/* Connection management */
struct bt_conn *ble_central_get_default_conn(void);
void ble_central_set_default_conn(struct bt_conn *conn);

/* Callback registration for external modules */
typedef void (*ble_central_connected_cb_t)(struct bt_conn *conn);
typedef void (*ble_central_disconnected_cb_t)(struct bt_conn *conn, uint8_t reason);
typedef void (*ble_central_security_changed_cb_t)(struct bt_conn *conn, bt_security_t level, enum bt_security_err err);

void ble_central_register_connected_cb(ble_central_connected_cb_t cb);
void ble_central_register_disconnected_cb(ble_central_disconnected_cb_t cb);
void ble_central_register_security_changed_cb(ble_central_security_changed_cb_t cb);

/* Authentication handling */
void ble_central_num_comp_reply(bool accept);
struct bt_conn *ble_central_get_auth_conn(void);
void ble_central_set_auth_conn(struct bt_conn *conn);
void ble_central_handle_buttons(uint32_t button_state, uint32_t has_changed);

/* Additional initialization functions */
int ble_central_init_callbacks(void);
int ble_central_init_auth_callbacks(void);

/* Get scan work for external scheduling */
struct k_work *ble_central_get_scan_work(void);

#endif /* BLE_CENTRAL_H */ 
```

## src/ble_nus_client.c
```c
/*
 * Copyright (c) 2025 Robert Dale Smith
 * Copyright (c) 2025 Augmental Tech
 *
 * SPDX-License-Identifier: Apache-2.0
 */

#include "ble_nus_client.h"
#include <zephyr/kernel.h>
#include <zephyr/bluetooth/bluetooth.h>
#include <zephyr/bluetooth/conn.h>
#include <zephyr/bluetooth/uuid.h>
#include <zephyr/bluetooth/gatt.h>
#include <bluetooth/services/nus_client.h>
#include <bluetooth/services/nus.h>
#include <bluetooth/gatt_dm.h>
#include <zephyr/logging/log.h>
#include <zephyr/sys/printk.h>

LOG_MODULE_REGISTER(ble_nus_client, LOG_LEVEL_INF);

/* NUS Client instance */
static struct bt_nus_client nus_client;

/* Callback functions for external modules */
static ble_nus_data_received_cb_t data_received_cb;
static ble_nus_data_sent_cb_t data_sent_cb;
static ble_nus_mtu_exchange_cb_t mtu_exchange_cb;
static ble_nus_discovery_complete_cb_t discovery_complete_cb;

/* Semaphore for NUS write operations */
K_SEM_DEFINE(nus_write_sem, 0, 1);

/* NUS Client callbacks */
static uint8_t nus_data_received(struct bt_nus_client *nus, const uint8_t *data, uint16_t len);
static void nus_data_sent(struct bt_nus_client *nus, uint8_t err, const uint8_t *const data, uint16_t len);

/* Discovery callbacks */
static void discovery_complete(struct bt_gatt_dm *dm, void *context);
static void discovery_service_not_found(struct bt_conn *conn, void *context);
static void discovery_error(struct bt_conn *conn, int err, void *context);

/* MTU exchange callback */
static void exchange_func(struct bt_conn *conn, uint8_t err, struct bt_gatt_exchange_params *params);

/* Discovery callback structure */
struct bt_gatt_dm_cb discovery_cb = {
	.completed = discovery_complete,
	.service_not_found = discovery_service_not_found,
	.error_found = discovery_error,
};

/* NUS Client callback implementations */
static uint8_t nus_data_received(struct bt_nus_client *nus, const uint8_t *data, uint16_t len)
{
	ARG_UNUSED(nus);

	// Call external data received callback if registered
	if (data_received_cb) {
		data_received_cb(data, len);
	}

	return BT_GATT_ITER_CONTINUE;
}

static void nus_data_sent(struct bt_nus_client *nus, uint8_t err, const uint8_t *const data, uint16_t len)
{
	ARG_UNUSED(nus);
	ARG_UNUSED(data);
	ARG_UNUSED(len);

	k_sem_give(&nus_write_sem);

	if (err) {
		LOG_WRN("ATT error code: 0x%02X", err);
	}

	// Call external data sent callback if registered
	if (data_sent_cb) {
		data_sent_cb(err);
	}
}

/* Discovery callback implementations */
static void discovery_complete(struct bt_gatt_dm *dm, void *context)
{
	struct bt_nus_client *nus = context;
	int err;
	
	LOG_INF("Service discovery completed");

	// Print detailed discovery data to see what's actually available
	LOG_INF("=== GATT DISCOVERY DATA ===");
	bt_gatt_dm_data_print(dm);
	LOG_INF("=== END GATT DISCOVERY DATA ===");

	// Check if we found any services at all
	const struct bt_gatt_dm_attr *service_attr = bt_gatt_dm_service_get(dm);
	if (!service_attr) {
		LOG_ERR("No services found in discovery data - device may not have any services");
		bt_gatt_dm_data_release(dm);
		return;
	}

	LOG_INF("Found at least one service, attempting NUS handle assignment");

	err = bt_nus_handles_assign(dm, nus);
	if (err) {
		LOG_ERR("Failed to assign NUS handles (err %d) - device may not have NUS TX/RX characteristics", err);
		LOG_ERR("This suggests the remote device doesn't have a proper NUS service implementation");
		LOG_ERR("The device might be advertising NUS UUID but not actually implementing the service");
		bt_gatt_dm_data_release(dm);
		return;
	}
	
	LOG_INF("NUS handles assigned successfully");

	// Don't attempt subscription immediately - follow HID pattern
	// Subscription will be handled later when needed

	err = bt_gatt_dm_data_release(dm);
	if (err) {
		LOG_ERR("Could not release the discovery data, error code: %d", err);
	}

	// Call external discovery complete callback if registered
	if (discovery_complete_cb) {
		discovery_complete_cb();
	}
}

static void discovery_service_not_found(struct bt_conn *conn, void *context)
{
	LOG_INF("Service not found");
}

static void discovery_error(struct bt_conn *conn, int err, void *context)
{
	LOG_WRN("Error while discovering GATT database: (%d)", err);
}

/* MTU exchange callback implementation */
static void exchange_func(struct bt_conn *conn, uint8_t err, struct bt_gatt_exchange_params *params)
{
	ARG_UNUSED(conn);
	ARG_UNUSED(params);

	if (!err) {
		uint16_t mtu = bt_gatt_get_mtu(conn);
		printk("*** MTU EXCHANGE SUCCESSFUL: MTU = %d bytes ***\n", mtu);
		LOG_INF("MTU exchange done, MTU: %d", mtu);

		// Call external MTU exchange callback if registered
		if (mtu_exchange_cb) {
			mtu_exchange_cb(mtu);
		}
	} else {
		printk("*** MTU EXCHANGE FAILED: error = %d ***\n", err);
		LOG_WRN("MTU exchange failed (err %" PRIu8 ")", err);
	}
}

/* Public API implementations */
int ble_nus_client_init(void)
{
	int err;
	struct bt_nus_client_init_param init = {
		.cb = {
			.received = nus_data_received,
			.sent = nus_data_sent,
		}
	};

	err = bt_nus_client_init(&nus_client, &init);
	if (err) {
		LOG_ERR("NUS Client initialization failed (err %d)", err);
		return err;
	}

	LOG_INF("NUS Client module initialized");
	return err;
}

int ble_nus_client_send_data(const uint8_t *data, uint16_t len)
{
	if (!data || len == 0) {
		return -EINVAL;
	}

	return bt_nus_client_send(&nus_client, data, len);
}

int ble_nus_client_subscribe(void)
{
	int err;
	
	LOG_INF("Attempting to subscribe to NUS receive");
	
	err = bt_nus_subscribe_receive(&nus_client);
	if (err) {
		LOG_ERR("Failed to subscribe to NUS receive (err %d)", err);
		return err;
	}
	
	LOG_INF("NUS subscription successful");
	return 0;
}

void ble_nus_client_discover(struct bt_conn *conn)
{
	int err;

	err = bt_gatt_dm_start(conn,
			       BT_UUID_NUS_SERVICE,
			       &discovery_cb,
			       &nus_client);
	if (err) {
		LOG_ERR("could not start the discovery procedure, error "
			"code: %d", err);
	}
}

void ble_nus_client_register_data_received_cb(ble_nus_data_received_cb_t cb)
{
	data_received_cb = cb;
}

void ble_nus_client_register_data_sent_cb(ble_nus_data_sent_cb_t cb)
{
	data_sent_cb = cb;
}

void ble_nus_client_register_mtu_exchange_cb(ble_nus_mtu_exchange_cb_t cb)
{
	mtu_exchange_cb = cb;
}

void ble_nus_client_register_discovery_complete_cb(ble_nus_discovery_complete_cb_t cb)
{
	discovery_complete_cb = cb;
}

struct bt_nus_client *ble_nus_client_get_instance(void)
{
	return &nus_client;
}

/* Helper function to perform MTU exchange */
int ble_nus_client_exchange_mtu(struct bt_conn *conn)
{
	int err;
	static struct bt_gatt_exchange_params exchange_params;

	exchange_params.func = exchange_func;
	// Request maximum MTU (247 bytes) to handle bigger packets
	err = bt_gatt_exchange_mtu(conn, &exchange_params);
	if (err) {
		LOG_WRN("MTU exchange failed (err %d)", err);
	}

	return err;
} 
```

## src/ble_nus_client.h
```c
/*
 * Copyright (c) 2025 Robert Dale Smith
 * Copyright (c) 2025 Augmental Tech
 *
 * SPDX-License-Identifier: Apache-2.0
 */

#ifndef BLE_NUS_CLIENT_H
#define BLE_NUS_CLIENT_H

#include <zephyr/kernel.h>
#include <zephyr/bluetooth/bluetooth.h>
#include <zephyr/bluetooth/conn.h>
#include <zephyr/bluetooth/gatt.h>
#include <bluetooth/services/nus_client.h>
#include <bluetooth/gatt_dm.h>

/* NUS Client initialization and control functions */
int ble_nus_client_init(void);
int ble_nus_client_send_data(const uint8_t *data, uint16_t len);
int ble_nus_client_subscribe(void);

/* Service discovery */
void ble_nus_client_discover(struct bt_conn *conn);

/* Callback registration for external modules */
typedef void (*ble_nus_data_received_cb_t)(const uint8_t *data, uint16_t len);
typedef void (*ble_nus_data_sent_cb_t)(uint8_t err);

void ble_nus_client_register_data_received_cb(ble_nus_data_received_cb_t cb);
void ble_nus_client_register_data_sent_cb(ble_nus_data_sent_cb_t cb);

/* Discovery complete callback */
typedef void (*ble_nus_discovery_complete_cb_t)(void);

void ble_nus_client_register_discovery_complete_cb(ble_nus_discovery_complete_cb_t cb);

/* Get NUS client instance for external use */
struct bt_nus_client *ble_nus_client_get_instance(void);

/* MTU exchange callback */
typedef void (*ble_nus_mtu_exchange_cb_t)(uint16_t mtu);

void ble_nus_client_register_mtu_exchange_cb(ble_nus_mtu_exchange_cb_t cb);

/* Helper function to perform MTU exchange */
int ble_nus_client_exchange_mtu(struct bt_conn *conn);

#endif /* BLE_NUS_CLIENT_H */ 
```

## src/ble_transport.c
```c
/*
 * Copyright (c) 2025 Robert Dale Smith
 * Copyright (c) 2025 Augmental Tech
 *
 * SPDX-License-Identifier: Apache-2.0
 */

#include <zephyr/kernel.h>
#include <zephyr/logging/log.h>
#include <zephyr/bluetooth/conn.h>
#include <zephyr/bluetooth/gatt.h>
#include <string.h>

#include "ble_transport.h"
#include "ble_central.h"
#include "ble_nus_client.h"
#include "usb_cdc.h"

#define LOG_MODULE_NAME ble_transport
LOG_MODULE_REGISTER(LOG_MODULE_NAME);

/* USB CDC callback */
static usb_cdc_send_cb_t usb_cdc_send_callback = NULL;

/* NUS Bridge state */
static bool nus_client_ready = false;
static bool mtu_exchange_complete = false;
static bool bridging_started = false;
static bool security_established = false;
static struct k_timer discovery_timeout_timer;

/* Future HID Bridge callbacks and state */
static ble_data_callback_t hid_data_callback = NULL;
static ble_ready_callback_t hid_ready_callback = NULL;
static bool hid_client_ready = false;

/* Internal callback functions */
static void ble_nus_data_received_cb(const uint8_t *data, uint16_t len);
static void ble_nus_discovery_complete_cb(void);
static void ble_nus_mtu_exchange_cb(uint16_t mtu);
static void ble_central_connected_cb(struct bt_conn *conn);
static void ble_central_disconnected_cb(struct bt_conn *conn, uint8_t reason);
static void ble_central_security_changed_cb(struct bt_conn *conn, bt_security_t level, enum bt_security_err err);
static void gatt_discover(struct bt_conn *conn);
static void discovery_timeout_handler(struct k_timer *timer);

/* BLE Transport initialization */
int ble_transport_init(void)
{
	int err;

	/* Register BLE Central callbacks */
	ble_central_register_connected_cb(ble_central_connected_cb);
	ble_central_register_disconnected_cb(ble_central_disconnected_cb);
	ble_central_register_security_changed_cb(ble_central_security_changed_cb);

	/* Initialize BLE Central */
	err = ble_central_init();
	if (err != 0) {
		LOG_ERR("ble_central_init failed (err %d)", err);
		return err;
	}

	/* Register NUS Client callbacks */
	ble_nus_client_register_data_received_cb(ble_nus_data_received_cb);
	ble_nus_client_register_discovery_complete_cb(ble_nus_discovery_complete_cb);
	ble_nus_client_register_mtu_exchange_cb(ble_nus_mtu_exchange_cb);
	
	/* Register USB CDC callback */
	ble_transport_register_usb_cdc_callback((usb_cdc_send_cb_t)usb_cdc_send_data);

	/* Initialize NUS client */
	err = ble_nus_client_init();
	if (err != 0) {
		LOG_ERR("ble_nus_client_init failed (err %d)", err);
		return err;
	}

	/* Initialize BLE Central callbacks (like HID firmware) */
	err = ble_central_init_callbacks();
	if (err != 0) {
		LOG_ERR("ble_central_init_callbacks failed (err %d)", err);
		return err;
	}

	/* Initialize BLE Central authentication callbacks (like HID firmware) */
	err = ble_central_init_auth_callbacks();
	if (err != 0) {
		LOG_ERR("ble_central_init_auth_callbacks failed (err %d)", err);
		return err;
	}

	/* Initialize discovery timeout timer */
	k_timer_init(&discovery_timeout_timer, discovery_timeout_handler, NULL);

	/* Start scanning */
	err = ble_central_start_scan();
	if (err) {
		LOG_ERR("Scan start failed (err %d)", err);
		return err;
	}

	return 0;
}

/* Transport registration functions */
int ble_transport_register_usb_cdc_callback(usb_cdc_send_cb_t cb)
{
	usb_cdc_send_callback = cb;
	return 0;
}

int ble_transport_start_bridging(void)
{
	bridging_started = true;
	LOG_INF("BLE Transport bridging started");
	return 0;
}

int ble_transport_send_nus_data(const uint8_t *data, uint16_t len)
{
	if (!nus_client_ready) {
		LOG_WRN("NUS client not ready");
		return -ENOTCONN;
	}

	// Check if the NUS client instance is properly initialized
	struct bt_nus_client *nus = ble_nus_client_get_instance();
	if (!nus) {
		LOG_ERR("NUS client instance not available");
		return -ENOTCONN;
	}

	LOG_INF("BLE Transport sending %d bytes to NUS", len);
	int err = ble_nus_client_send_data(data, len);
	if (err) {
		LOG_ERR("BLE Transport send failed: %d", err);
	} else {
		LOG_INF("BLE Transport send successful");
	}
	return err;
}

bool ble_transport_is_nus_ready(void)
{
	return nus_client_ready;
}

/* Future HID Transport functions */
int ble_transport_register_hid_data_callback(ble_data_callback_t cb)
{
	hid_data_callback = cb;
	return 0;
}

int ble_transport_register_hid_ready_callback(ble_ready_callback_t cb)
{
	hid_ready_callback = cb;
	return 0;
}

int ble_transport_send_hid_data(const uint8_t *data, uint16_t len)
{
	if (!hid_client_ready) {
		LOG_WRN("HID client not ready");
		return -ENOTCONN;
	}

	// TODO: Implement HID client send when HID bridge is added
	return -ENOSYS;
}

bool ble_transport_is_hid_ready(void)
{
	return hid_client_ready;
}

/* Internal callback functions */
static void ble_nus_data_received_cb(const uint8_t *data, uint16_t len)
{
	LOG_INF("NUS data received: %d bytes", len);
	
	// Only process data after MTU exchange is complete
	if (!mtu_exchange_complete) {
		LOG_DBG("Skipping data - MTU exchange not complete");
		return;
	}
	
	// Debug: Log the first few bytes to see what we're getting
	if (len > 0) {
		LOG_INF("First bytes: %02x %02x %02x %02x", 
			data[0], len > 1 ? data[1] : 0, len > 2 ? data[2] : 0, len > 3 ? data[3] : 0);
	}
	
	// Filter out 2-byte echo responses (73 XX format)
	if (len == 2 && data[0] == 0x73) {
		LOG_DBG("Skipping 2-byte echo: 73 %02x", data[1]);
		return;
	}
	
	// Don't echo back single characters (likely echo from our input)
	if (len == 1) {
		LOG_DBG("Skipping single character echo");
		return;
	}
	
	// For larger packets, try to identify the structure
	if (len >= 4) {
		LOG_INF("PACKET STRUCTURE: Type=0x%02x, Length=%d", data[0], len);
	}
	
	// Bridge NUS data directly to USB CDC
	if (usb_cdc_send_callback) {
		usb_cdc_send_callback(data, len);
	}
}

static void ble_nus_mtu_exchange_cb(uint16_t mtu)
{
	LOG_INF("MTU exchange completed: %d bytes", mtu);
	mtu_exchange_complete = true;
}

static void ble_central_security_changed_cb(struct bt_conn *conn, bt_security_t level, enum bt_security_err err)
{
	if (!err) {
		LOG_INF("Security established successfully (level %u)", level);
		security_established = true;
	} else {
		LOG_WRN("Security failed (level %u, err %d)", level, err);
		security_established = false;
		
		// Log what the security error means
		switch (err) {
		case BT_SECURITY_ERR_AUTH_FAIL:
			LOG_WRN("Authentication failed - device may require pairing");
			break;
		case BT_SECURITY_ERR_PIN_OR_KEY_MISSING:
			LOG_WRN("PIN or key missing - device may require bonding");
			break;
		case BT_SECURITY_ERR_OOB_NOT_AVAILABLE:
			LOG_WRN("OOB not available");
			break;
		case BT_SECURITY_ERR_PAIR_NOT_SUPPORTED:
			LOG_WRN("Pairing not supported by device");
			break;
		default:
			LOG_WRN("Unknown security error: %d", err);
			break;
		}
		
		// For error 4 (BT_SECURITY_ERR_AUTH_FAIL), try to continue anyway
		if (err == BT_SECURITY_ERR_AUTH_FAIL) {
			LOG_INF("Continuing with discovery despite authentication failure");
		}
	}
}

static void ble_nus_discovery_complete_cb(void)
{
	LOG_INF("NUS client ready - service discovery complete");
	
	// Stop the discovery timeout timer
	k_timer_stop(&discovery_timeout_timer);
	
	if (!security_established) {
		LOG_WRN("NUS discovery completed but security not established - bridge may not work properly");
	}
	
	nus_client_ready = true;
	
	// Attempt subscription after a short delay to ensure connection is stable
	k_sleep(K_MSEC(500));
	
	int err = ble_nus_client_subscribe();
	if (err) {
		LOG_WRN("NUS subscription failed (err %d) - bridge may not receive data", err);
	} else {
		LOG_INF("NUS subscription successful");
	}
	
	LOG_INF("NUS client ready - bridge operational");
}

static void gatt_discover(struct bt_conn *conn)
{
	if (conn != ble_central_get_default_conn()) {
		return;
	}

	LOG_INF("Starting GATT discovery with 10 second timeout");
	
	// Start discovery timeout timer
	k_timer_start(&discovery_timeout_timer, K_SECONDS(10), K_NO_WAIT);
	
	ble_nus_client_discover(conn);
}

static void discovery_timeout_handler(struct k_timer *timer)
{
	ARG_UNUSED(timer);
	
	LOG_ERR("GATT discovery timeout - device may not have proper NUS service");
	
	// Reset ready states since discovery failed
	nus_client_ready = false;
	mtu_exchange_complete = false;
	security_established = false;
	
	// Disconnect to try again
	struct bt_conn *conn = ble_central_get_default_conn();
	if (conn) {
		LOG_INF("Disconnecting due to discovery timeout");
		bt_conn_disconnect(conn, BT_HCI_ERR_REMOTE_USER_TERM_CONN);
	}
}

static void ble_central_connected_cb(struct bt_conn *conn)
{
	int err;

	LOG_INF("BLE Central connected - starting setup");

	// Reset security state
	security_established = false;

	// Perform MTU exchange using the NUS client module
	err = ble_nus_client_exchange_mtu(conn);
	if (err) {
		LOG_WRN("MTU exchange failed (err %d)", err);
	} else {
		LOG_INF("MTU exchange initiated successfully");
	}

	err = bt_conn_set_security(conn, BT_SECURITY_L3);
	if (err) {
		LOG_WRN("Failed to set security: %d", err);
		// Try discovery anyway, but log the security issue
		gatt_discover(conn);
	} else {
		LOG_INF("Security setup successful");
		security_established = true;
		gatt_discover(conn);
	}
}

static void ble_central_disconnected_cb(struct bt_conn *conn, uint8_t reason)
{
	ARG_UNUSED(conn);
	ARG_UNUSED(reason);
	
	// Stop discovery timeout timer
	k_timer_stop(&discovery_timeout_timer);
	
	// Reset ready states
	nus_client_ready = false;
	hid_client_ready = false;
	mtu_exchange_complete = false;
	security_established = false;
	
	LOG_INF("BLE Central disconnected - resetting bridge states");
} 
```
