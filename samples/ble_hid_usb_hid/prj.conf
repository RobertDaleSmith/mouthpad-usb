## CMakeLists.txt
```
cmake_minimum_required(VERSION 3.20.0)
find_package(Zephyr REQUIRED HINTS $ENV{ZEPHYR_BASE})
project(mouthpad_usb)

target_sources(app PRIVATE
  src/ble_transport.c
  src/ble_hid.c
  src/ble_central.c
  src/usb_hid.c
  src/main.c
)
```

## Kconfig
```
#
# Copyright (c) 2024 Nordic Semiconductor
#
# SPDX-License-Identifier: LicenseRef-Nordic-5-Clause
#

source "Kconfig.zephyr"

config SETTINGS
	default y

config ZMS
	bool
	default y if (SOC_FLASH_NRF_RRAM || SOC_FLASH_NRF_MRAM)

config NVS
	default y if !(SOC_FLASH_NRF_RRAM || SOC_FLASH_NRF_MRAM)
```

## prj.conf
```kconfig
#
# Copyright (c) 2019 Nordic Semiconductor ASA
#
# SPDX-License-Identifier: LicenseRef-Nordic-5-Clause
#

CONFIG_NCS_SAMPLES_DEFAULTS=y

# BLE Central
CONFIG_BT=y
CONFIG_BT_CENTRAL=y
CONFIG_BT_SMP=y
CONFIG_BT_BONDABLE=y
# CONFIG_BT_SMP_SC_ONLY is not enforced to allow legacy if peer lacks SC
# IO capability is inferred from auth callbacks; no explicit Kconfig needed
CONFIG_BT_SMP_APP_PAIRING_ACCEPT=y
CONFIG_BT_ATT_TX_COUNT=5
CONFIG_BT_GATT_CLIENT=y
CONFIG_BT_GATT_DM=y
CONFIG_BT_HOGP=y
CONFIG_HEAP_MEM_POOL_SIZE=2048

CONFIG_BT_SCAN=y
CONFIG_BT_SCAN_FILTER_ENABLE=y
CONFIG_BT_SCAN_UUID_CNT=1
CONFIG_BT_SCAN_ADDRESS_CNT=1
CONFIG_BT_PRIVACY=y

CONFIG_MAIN_STACK_SIZE=2048
CONFIG_SYSTEM_WORKQUEUE_STACK_SIZE=2048

CONFIG_BT_SETTINGS=y
CONFIG_FLASH=y
CONFIG_FLASH_PAGE_LAYOUT=y
CONFIG_FLASH_MAP=y

CONFIG_DK_LIBRARY=y

# USB HID
CONFIG_USB_DEVICE_STACK=y
CONFIG_USB_DEVICE_HID=y
CONFIG_USB_DEVICE_PRODUCT="MouthPad^USB"
CONFIG_USB_DEVICE_PID=0xEEEE
CONFIG_USB_DEVICE_VID=0x1915

CONFIG_USB_DEVICE_INITIALIZE_AT_BOOT=n

CONFIG_LOG=y
CONFIG_USB_DRIVER_LOG_LEVEL_ERR=y
CONFIG_USB_DEVICE_LOG_LEVEL_ERR=y

CONFIG_GPIO=y
CONFIG_INPUT=y
CONFIG_INPUT_MODE_SYNCHRONOUS=y

# Console & Logging
CONFIG_PRINTK=y
CONFIG_LOG=y
CONFIG_LOG_MODE_IMMEDIATE=y

# Enable RTT for console output (instead of UART)
CONFIG_USE_SEGGER_RTT=y
CONFIG_RTT_CONSOLE=y
CONFIG_UART_CONSOLE=n
CONFIG_LOG_BACKEND_RTT=y
CONFIG_LOG_BACKEND_UART=n

# UF2 Bootloader Support
CONFIG_BUILD_OUTPUT_UF2=y
```

## usbd_next.overlay
```dts
/*
 * Copyright (c) 2023 Nordic Semiconductor ASA
 *
 * SPDX-License-Identifier: Apache-2.0
 */

/ {
	hid_dev_0: hid_dev_0 {
		compatible = "zephyr,hid-device";
		label = "HID0";
		protocol-code = "none";
		in-polling-period-us = <1000>;
		in-report-size = <64>;
	};
};
```

## src/main.c
```c
/*
 * Copyright (c) 2025 Robert Dale Smith
 * Copyright (c) 2025 Augmental Tech
 *
 * SPDX-License-Identifier: Apache-2.0
 */

#include <zephyr/kernel.h>
#include <zephyr/logging/log.h>
#include "ble_transport.h"
#include "usb_hid.h"

LOG_MODULE_REGISTER(main, LOG_LEVEL_INF);

int main(void)
{
	printk("MouthPad^USB Bridge Started\n");

	/* Initialize BLE Transport */
	if (ble_transport_init() != 0) {
		printk("BLE Transport initialization failed\n");
		return 0;
	}

	/* Initialize USB */
	if (usb_init() != 0) {
		printk("USB initialization failed\n");
		return 0;
	}

	printk("MouthPad^USB Bridge initialization complete\n");
}
```

## src/ble_central.c
```c
/*
 * Copyright (c) 2025 Robert Dale Smith
 * Copyright (c) 2025 Augmental Tech
 *
 * SPDX-License-Identifier: Apache-2.0
 */

#include <zephyr/types.h>
#include <stddef.h>
#include <errno.h>
#include <zephyr/kernel.h>
#include <zephyr/sys/printk.h>

#include <zephyr/bluetooth/bluetooth.h>
#include <zephyr/bluetooth/hci.h>
#include <zephyr/bluetooth/conn.h>
#include <zephyr/bluetooth/uuid.h>
#include <zephyr/bluetooth/gatt.h>
#include <bluetooth/gatt_dm.h>
#include <zephyr/sys/byteorder.h>
#include <bluetooth/scan.h>
#include <bluetooth/services/hogp.h>

#include <zephyr/logging/log.h>
#include <dk_buttons_and_leds.h>

#include "ble_central.h"

LOG_MODULE_REGISTER(ble_central, LOG_LEVEL_INF);

/* Key used to accept or reject passkey value */
#define KEY_PAIRING_ACCEPT DK_BTN1_MSK
#define KEY_PAIRING_REJECT DK_BTN2_MSK

/* BLE Central variables */
static struct bt_conn *default_conn;
static struct bt_conn *auth_conn;
static struct k_work_delayable sec_retry_work;
static struct bt_conn *sec_retry_conn;

/* Callback registration */
static ble_connected_cb_t connected_callback = NULL;
static ble_disconnected_cb_t disconnected_callback = NULL;

/* Forward declarations */
static void gatt_discover(struct bt_conn *conn);
static bool le_param_req(struct bt_conn *conn, struct bt_le_conn_param *param);
static void le_param_updated(struct bt_conn *conn, uint16_t interval, uint16_t latency, uint16_t timeout);
static void sec_retry_work_handler(struct k_work *work)
{
	ARG_UNUSED(work);
	if (!sec_retry_conn) {
		return;
	}
	int err = bt_conn_set_security(sec_retry_conn, BT_SECURITY_L1);
	printk("bt_conn_set_security retry -> %d\n", err);
	if (err == -EBUSY || err == -EINVAL) {
		k_work_reschedule(&sec_retry_work, K_MSEC(100));
		return;
	}
	bt_conn_unref(sec_retry_conn);
	sec_retry_conn = NULL;
}

/* Scan callback functions */
static void scan_filter_match(struct bt_scan_device_info *device_info,
			      struct bt_scan_filter_match *filter_match,
			      bool connectable)
{
	char addr[BT_ADDR_LE_STR_LEN];

	if (!filter_match->uuid.match ||
	    (filter_match->uuid.count != 1)) {

		printk("Invalid device connected\n");

		return;
	}

	const struct bt_uuid *uuid = filter_match->uuid.uuid[0];

	bt_addr_le_to_str(device_info->recv_info->addr, addr, sizeof(addr));

	printk("Filters matched on UUID 0x%04x.\nAddress: %s connectable: %s\n",
		BT_UUID_16(uuid)->val,
		addr, connectable ? "yes" : "no");
}

static void scan_connecting_error(struct bt_scan_device_info *device_info)
{
	printk("Connecting failed\n");
}

static void scan_connecting(struct bt_scan_device_info *device_info,
			    struct bt_conn *conn)
{
	ble_central_set_default_conn(bt_conn_ref(conn));
}

static void scan_filter_no_match(struct bt_scan_device_info *device_info,
				 bool connectable)
{
	int err;
	struct bt_conn *conn = NULL;
	char addr[BT_ADDR_LE_STR_LEN];

	if (device_info->recv_info->adv_type == BT_GAP_ADV_TYPE_ADV_DIRECT_IND) {
		bt_addr_le_to_str(device_info->recv_info->addr, addr,
				  sizeof(addr));
		printk("Direct advertising received from %s\n", addr);
		bt_scan_stop();

		err = bt_conn_le_create(device_info->recv_info->addr,
					BT_CONN_LE_CREATE_CONN,
					device_info->conn_param, &conn);

		if (!err) {
			ble_central_set_default_conn(bt_conn_ref(conn));
			bt_conn_unref(conn);
		}
	}
}

BT_SCAN_CB_INIT(scan_cb, scan_filter_match, scan_filter_no_match,
		scan_connecting_error, scan_connecting);

/* Scan initialization moved to after bt_enable() like HID Remapper */

int ble_central_init(void)
{
	LOG_INF("Initializing BLE Central...");
	k_work_init_delayable(&sec_retry_work, sec_retry_work_handler);
	/* Scan init moved to after bt_enable() */
	LOG_INF("✓ BLE Central initialized");
	return 0;
}

int ble_central_start_scan(void)
{
	int err;

	err = bt_scan_start(BT_SCAN_TYPE_SCAN_PASSIVE);
	if (err) {
		printk("Scanning failed to start (err %d)\n", err);
		return err;
	}

	printk("Scanning successfully started\n");
	return 0;
}

int ble_central_stop_scan(void)
{
	bt_scan_stop();
	return 0;
}

struct bt_conn *ble_central_get_default_conn(void)
{
	return default_conn;
}

void ble_central_set_default_conn(struct bt_conn *conn)
{
	default_conn = conn;
}

struct bt_conn *ble_central_get_auth_conn(void)
{
	return auth_conn;
}

void ble_central_set_auth_conn(struct bt_conn *conn)
{
	auth_conn = conn;
}

/* Connection callback functions */
static void connected(struct bt_conn *conn, uint8_t conn_err)
{
	int err;
	char addr[BT_ADDR_LE_STR_LEN];

	bt_addr_le_to_str(bt_conn_get_dst(conn), addr, sizeof(addr));

	if (conn_err) {
		printk("Failed to connect to %s, 0x%02x (reason %d)\n", addr, conn_err, conn_err);
		if (conn == ble_central_get_default_conn()) {
			bt_conn_unref(ble_central_get_default_conn());
			ble_central_set_default_conn(NULL);

			/* Let bt_scan module handle restarting automatically */
			printk("Connection failed - bt_scan module will restart scan automatically\n");
		}

		return;
	}

	printk("Connected: %s\n", addr);

	/* Try different approach: Don't request security at all initially */
	/* Just proceed directly to GATT discovery and let the device request security if needed */
	printk("Skipping initial security request - proceeding to GATT discovery\n");

	/* Start GATT discovery immediately */
	gatt_discover(conn);

	/* Call transport layer callback if registered */
	if (connected_callback) {
		connected_callback(conn);
	}
}

static void disconnected(struct bt_conn *conn, uint8_t reason)
{
	char addr[BT_ADDR_LE_STR_LEN];
	int err;

	bt_addr_le_to_str(bt_conn_get_dst(conn), addr, sizeof(addr));

	if (ble_central_get_auth_conn()) {
		bt_conn_unref(ble_central_get_auth_conn());
		ble_central_set_auth_conn(NULL);
	}

	printk("Disconnected: %s, reason 0x%02x (%d)\n", addr, reason, reason);

	/* Release HOGP if active - this will be handled by ble.c */
	extern struct bt_hogp *ble_hid_get_hogp(void);
	extern bool bt_hogp_assign_check(const struct bt_hogp *hogp);
	extern void bt_hogp_release(struct bt_hogp *hogp);
	
	struct bt_hogp *hogp = ble_hid_get_hogp();
	if (bt_hogp_assign_check(hogp)) {
		printk("HIDS client active - releasing");
		bt_hogp_release(hogp);
	}

	if (ble_central_get_default_conn() != conn) {
		return;
	}

	bt_conn_unref(ble_central_get_default_conn());
	ble_central_set_default_conn(NULL);

	/* Backoff on Repeated Attempts (0x13) or Connection Timeout (0x08) */
	if (reason == 0x13 || reason == 0x08) {
			k_sleep(K_SECONDS(3));
	}
	/* Let bt_scan module handle restarting automatically */
	/* The scan module with connect_if_match=1 will restart scanning automatically */
	printk("Disconnected - bt_scan module will restart scan automatically\n");

	/* Call transport layer callback if registered */
	if (disconnected_callback) {
		disconnected_callback(conn, reason);
	}
}

static void security_changed(struct bt_conn *conn, bt_security_t level,
			     enum bt_security_err err)
{
	char addr[BT_ADDR_LE_STR_LEN];

	bt_addr_le_to_str(bt_conn_get_dst(conn), addr, sizeof(addr));

	if (!err) {
		printk("Security changed: %s level %u\n", addr, level);

		/* Security upgrade successful - GATT discovery should already be running */
		/* This is just informational now since we start discovery immediately */
		if (level >= BT_SECURITY_L2) {
			printk("Encryption established (level %u)\n", level);
		}
	} else {
		printk("Security failed: %s level %u err %d\n", addr, level, err);

		/* Handle security failures */
		if (err == BT_SECURITY_ERR_AUTH_FAIL) {
			printk("Authentication failed - device may need re-pairing\n");
		} else if (err == BT_SECURITY_ERR_PIN_OR_KEY_MISSING) {
			printk("Bonding information missing\n");
		}
	}
}

BT_CONN_CB_DEFINE(conn_callbacks) = {
	.connected        = connected,
	.disconnected     = disconnected,
	.security_changed = security_changed,
	.le_param_req     = le_param_req,
	.le_param_updated = le_param_updated
};

/* GATT Discovery callback functions */
static void discovery_completed_cb(struct bt_gatt_dm *dm,
				   void *context)
{
	int err;
	struct bt_conn *conn = bt_gatt_dm_conn_get(dm);

	printk("The discovery procedure succeeded\n");

	bt_gatt_dm_data_print(dm);

	/* Check security level and request upgrade if needed */
	bt_security_t sec = bt_conn_get_security(conn);
	printk("Discovery complete - current security level: %d\n", sec);

	if (sec < BT_SECURITY_L2) {
		printk("Requesting L2 security before HOGP init...\n");
		err = bt_conn_set_security(conn, BT_SECURITY_L2);
		if (err) {
			printk("Security request failed: %d, continuing anyway\n", err);
		} else {
			printk("Security upgrade requested\n");
		}
	}

	printk("Proceeding with HOGP setup...\n");
	extern struct bt_hogp *ble_hid_get_hogp(void);
	struct bt_hogp *hogp = ble_hid_get_hogp();
	err = bt_hogp_handles_assign(dm, hogp);
	if (err) {
		printk("Could not init HIDS client object, error: %d\n", err);
	}

	err = bt_gatt_dm_data_release(dm);
	if (err) {
		printk("Could not release the discovery data, error "
		       "code: %d\n", err);
	}
}

static void discovery_service_not_found_cb(struct bt_conn *conn,
					   void *context)
{
	printk("The service could not be found during the discovery\n");
}

static void discovery_error_found_cb(struct bt_conn *conn,
				     int err,
				     void *context)
{
	printk("The discovery procedure failed with %d\n", err);
}

/* Connection parameter callbacks (mirror HID Remapper behavior) */
static bool le_param_req(struct bt_conn *conn, struct bt_le_conn_param *param)
{
	/* Keep max equal to min */
	param->interval_max = param->interval_min;
	return true;
}

static void le_param_updated(struct bt_conn *conn, uint16_t interval, uint16_t latency, uint16_t timeout)
{
	ARG_UNUSED(conn);
	ARG_UNUSED(interval);
	ARG_UNUSED(latency);
	ARG_UNUSED(timeout);
}

static const struct bt_gatt_dm_cb discovery_cb = {
	.completed = discovery_completed_cb,
	.service_not_found = discovery_service_not_found_cb,
	.error_found = discovery_error_found_cb,
};

static void gatt_discover(struct bt_conn *conn)
{
	int err;

	if (conn != ble_central_get_default_conn()) {
		return;
	}

	printk("Starting GATT discovery for HID service\n");
	err = bt_gatt_dm_start(conn, BT_UUID_HIDS, &discovery_cb, NULL);
	if (err) {
		printk("Could not start the discovery procedure, error code: %d\n", err);
		
		/* If discovery fails due to insufficient security, the stack will request upgrade */
		if (err == -EPERM) {
			printk("Discovery blocked by insufficient security - waiting for security upgrade\n");
		}
	} else {
		printk("GATT discovery started successfully\n");
	}
}

int ble_central_gatt_discover(struct bt_conn *conn)
{
	gatt_discover(conn);
	return 0;
}

/* Authentication callback functions */
static void auth_passkey_display(struct bt_conn *conn, unsigned int passkey)
{
	char addr[BT_ADDR_LE_STR_LEN];

	bt_addr_le_to_str(bt_conn_get_dst(conn), addr, sizeof(addr));

	printk("Passkey for %s: %06u\n", addr, passkey);
}

static void auth_passkey_confirm(struct bt_conn *conn, unsigned int passkey)
{
	ARG_UNUSED(passkey);
	bt_conn_auth_passkey_confirm(conn);
	printk("Numeric comparison auto-accepted\n");
}

static void auth_cancel(struct bt_conn *conn)
{
	char addr[BT_ADDR_LE_STR_LEN];

	bt_addr_le_to_str(bt_conn_get_dst(conn), addr, sizeof(addr));

	printk("Pairing cancelled: %s\n", addr);
}

static void pairing_complete(struct bt_conn *conn, bool bonded)
{
	char addr[BT_ADDR_LE_STR_LEN];

	bt_addr_le_to_str(bt_conn_get_dst(conn), addr, sizeof(addr));

	printk("Pairing completed: %s, bonded: %d\n", addr, bonded);
}

static void pairing_failed(struct bt_conn *conn, enum bt_security_err reason)
{
	char addr[BT_ADDR_LE_STR_LEN];

	bt_addr_le_to_str(bt_conn_get_dst(conn), addr, sizeof(addr));

	printk("Pairing failed conn: %s, reason %d\n", addr, reason);
}

static void pairing_confirm(struct bt_conn *conn)
{
	char addr[BT_ADDR_LE_STR_LEN];
	bt_addr_le_to_str(bt_conn_get_dst(conn), addr, sizeof(addr));
	printk("Just Works pairing request from %s - auto-accepting\n", addr);
	bt_conn_auth_pairing_confirm(conn);
}

/* Use pairing_confirm to auto-accept Just Works pairing */
static struct bt_conn_auth_cb conn_auth_callbacks = {
	.passkey_display = auth_passkey_display,
	.pairing_confirm = pairing_confirm,  /* Auto-accept Just Works pairing */
	.passkey_confirm = auth_passkey_confirm,  /* Auto-accept numeric comparison */
	.cancel = auth_cancel,
};

static struct bt_conn_auth_info_cb conn_auth_info_callbacks = {
	.pairing_complete = pairing_complete,
	.pairing_failed = pairing_failed
};

void ble_central_num_comp_reply(bool accept)
{
	if (accept) {
		bt_conn_auth_passkey_confirm(ble_central_get_auth_conn());
		printk("Numeric Match, conn %p\n", ble_central_get_auth_conn());
	} else {
		bt_conn_auth_cancel(ble_central_get_auth_conn());
		printk("Numeric Reject, conn %p\n", ble_central_get_auth_conn());
	}

	bt_conn_unref(ble_central_get_auth_conn());
	ble_central_set_auth_conn(NULL);
}

int ble_central_init_auth_callbacks(void)
{
	int err;

	/* Check if callbacks are already registered */
	static bool callbacks_registered = false;
	if (callbacks_registered) {
		LOG_WRN("Auth callbacks already registered");
		return 0;
	}

	/* Register auth callbacks */
	err = bt_conn_auth_cb_register(&conn_auth_callbacks);
	if (err) {
		printk("Failed to register authorization callbacks (err %d).\n", err);
		
		/* -EINVAL can mean callbacks already registered */
		if (err == -EINVAL) {
			printk("Note: Callbacks might already be registered or invalid\n");
		}
		return err;
	}

	err = bt_conn_auth_info_cb_register(&conn_auth_info_callbacks);
	if (err) {
		printk("Failed to register authorization info callbacks (err %d).\n", err);
		return err;
	}

	callbacks_registered = true;
	LOG_INF("BLE Central auth callbacks initialized");
	return 0;
}

void ble_central_handle_buttons(uint32_t button_state, uint32_t has_changed)
{
	uint32_t button = button_state & has_changed;

	if (ble_central_get_auth_conn()) {
		if (button & KEY_PAIRING_ACCEPT) {
			ble_central_num_comp_reply(true);
		}

		if (button & KEY_PAIRING_REJECT) {
			ble_central_num_comp_reply(false);
		}

		return;
	}
}

int ble_central_init_callbacks(void)
{
	LOG_INF("BLE Central callbacks initialized");
	return 0;
}

int ble_central_register_connected_cb(ble_connected_cb_t cb)
{
	connected_callback = cb;
	return 0;
}

int ble_central_register_disconnected_cb(ble_disconnected_cb_t cb)
{
	disconnected_callback = cb;
	return 0;
}

int ble_central_init_scan(void)
{
	LOG_INF("Initializing BLE scan after Bluetooth enabled...");
	
	/* Match HID Remapper conn params: 7.5 ms interval, latency 44, timeout 4 s */
	static const struct bt_le_conn_param custom_conn_param = {
		.interval_min = 6,
		.interval_max = 6,
		.latency = 44,
		.timeout = 400,
	};

	struct bt_scan_init_param scan_init = {
		.connect_if_match = 1,
		.scan_param = NULL,
        .conn_param = &custom_conn_param
	};

	/* Initialize scan module (like HID Remapper does after bt_enable) */
	bt_scan_init(&scan_init);
	bt_scan_cb_register(&scan_cb);

	LOG_INF("BLE scan initialized successfully");
	return 0;
}

int ble_central_setup_scan_filters(void)
{
	int err;

	LOG_INF("Setting up scan filters...");
	
	/* Remove all existing filters first (like HID Remapper) */
	bt_scan_filter_remove_all();

	/* Add UUID filter for HID service (like HID Remapper) */
	err = bt_scan_filter_add(BT_SCAN_FILTER_TYPE_UUID, BT_UUID_HIDS);
	if (err) {
		LOG_ERR("Cannot add UUID scan filter (err %d)", err);
		return err;
	}

	/* Enable UUID filter with match-all flag (like HID Remapper) */
	err = bt_scan_filter_enable(BT_SCAN_UUID_FILTER, true);
	if (err) {
		LOG_ERR("Cannot enable scan filters (err %d)", err);
		return err;
	}

	LOG_INF("Scan filters set up successfully");
	return 0;
}
```

## src/ble_central.h
```c
#ifndef BLE_CENTRAL_H
#define BLE_CENTRAL_H

#include <zephyr/bluetooth/bluetooth.h>
#include <zephyr/bluetooth/conn.h>
#include <bluetooth/scan.h>

#ifdef __cplusplus
extern "C" {
#endif

/**
 * @brief Initialize BLE Central functionality
 *
 * @return 0 on success, negative error code on failure
 */
int ble_central_init(void);

/**
 * @brief Start scanning for BLE devices
 *
 * @return 0 on success, negative error code on failure
 */
int ble_central_start_scan(void);

/**
 * @brief Stop scanning for BLE devices
 *
 * @return 0 on success, negative error code on failure
 */
int ble_central_stop_scan(void);

/**
 * @brief Get the default connection
 *
 * @return Pointer to the default connection, or NULL if not connected
 */
struct bt_conn *ble_central_get_default_conn(void);

/**
 * @brief Set the default connection
 *
 * @param conn Connection to set as default
 */
void ble_central_set_default_conn(struct bt_conn *conn);

/**
 * @brief Get the authentication connection
 *
 * @return Pointer to the authentication connection, or NULL if not in auth
 */
struct bt_conn *ble_central_get_auth_conn(void);

/**
 * @brief Set the authentication connection
 *
 * @param conn Connection to set as auth connection
 */
void ble_central_set_auth_conn(struct bt_conn *conn);

/**
 * @brief Initialize BLE Central connection callbacks
 *
 * @return 0 on success, negative error code on failure
 */
int ble_central_init_callbacks(void);

/**
 * @brief Start GATT discovery on a connection
 *
 * @param conn Connection to discover services on
 * @return 0 on success, negative error code on failure
 */
int ble_central_gatt_discover(struct bt_conn *conn);

/**
 * @brief Handle numeric comparison reply for pairing
 *
 * @param accept Whether to accept or reject the pairing
 */
void ble_central_num_comp_reply(bool accept);

/**
 * @brief Initialize BLE Central authentication callbacks
 *
 * @return 0 on success, negative error code on failure
 */
int ble_central_init_auth_callbacks(void);

/**
 * @brief Handle button events for BLE Central functionality
 *
 * @param button_state The button state
 * @param has_changed Which buttons have changed
 */
void ble_central_handle_buttons(uint32_t button_state, uint32_t has_changed);

/* Callback function types */
typedef void (*ble_connected_cb_t)(struct bt_conn *conn);
typedef void (*ble_disconnected_cb_t)(struct bt_conn *conn, uint8_t reason);

/**
 * @brief Register connection callback
 *
 * @param cb Callback function for connection events
 * @return 0 on success, negative error code on failure
 */
int ble_central_register_connected_cb(ble_connected_cb_t cb);

/**
 * @brief Register disconnection callback
 *
 * @param cb Callback function for disconnection events
 * @return 0 on success, negative error code on failure
 */
int ble_central_register_disconnected_cb(ble_disconnected_cb_t cb);

/**
 * @brief Initialize BLE scan after Bluetooth is enabled
 *
 * @return 0 on success, negative error code on failure
 */
int ble_central_init_scan(void);

/**
 * @brief Setup scan filters for BLE devices
 *
 * @return 0 on success, negative error code on failure
 */
int ble_central_setup_scan_filters(void);

#ifdef __cplusplus
}
#endif

#endif /* BLE_CENTRAL_H */ 
```

## src/ble_hid.c
```c
/*
 * Copyright (c) 2025 Robert Dale Smith
 * Copyright (c) 2025 Augmental Tech
 *
 * SPDX-License-Identifier: Apache-2.0
 */

#include <zephyr/types.h>
#include <stddef.h>
#include <errno.h>
#include <zephyr/kernel.h>
#include <zephyr/sys/printk.h>

#include <zephyr/bluetooth/bluetooth.h>
#include <zephyr/bluetooth/hci.h>
#include <zephyr/bluetooth/conn.h>
#include <zephyr/bluetooth/uuid.h>
#include <zephyr/bluetooth/gatt.h>
#include <bluetooth/gatt_dm.h>
#include <zephyr/sys/byteorder.h>
#include <bluetooth/scan.h>
#include <bluetooth/services/hogp.h>
#include <dk_buttons_and_leds.h>

#include <zephyr/settings/settings.h>
#include <zephyr/logging/log.h>
#include <zephyr/usb/usb_device.h>
#include <zephyr/usb/class/usb_hid.h>

#include "ble_hid.h"

/* Forward declarations for direct USB access */
extern const struct device *hid_dev;
extern struct k_sem ep_write_sem;

LOG_MODULE_REGISTER(ble_hid, LOG_LEVEL_INF);

/* Callback registration */
static ble_hid_data_received_cb_t data_received_callback = NULL;
static ble_hid_ready_cb_t ready_callback = NULL;

/**
 * Switch between boot protocol and report protocol mode.
 */
#define KEY_BOOTMODE_MASK DK_BTN2_MSK
/**
 * Switch CAPSLOCK state.
 *
 * @note
 * For simplicity of the code it works only in boot mode.
 */
#define KEY_CAPSLOCK_MASK DK_BTN1_MSK
/**
 * Switch CAPSLOCK state with response
 *
 * Write CAPSLOCK with response.
 * Just for testing purposes.
 * The result should be the same like usine @ref KEY_CAPSLOCK_MASK
 */
#define KEY_CAPSLOCK_RSP_MASK DK_BTN3_MSK

static struct bt_hogp hogp;
static uint8_t capslock_state;
static bool hid_ready = false;

static void hids_on_ready(struct k_work *work);
static K_WORK_DEFINE(hids_ready_work, hids_on_ready);

/* HOGP callback functions */
static uint8_t hogp_notify_cb(struct bt_hogp *hogp,
			     struct bt_hogp_rep_info *rep,
			     uint8_t err,
			     const uint8_t *data);
static uint8_t hogp_boot_mouse_report(struct bt_hogp *hogp,
				     struct bt_hogp_rep_info *rep,
				     uint8_t err,
				     const uint8_t *data);
static uint8_t hogp_boot_kbd_report(struct bt_hogp *hogp,
				   struct bt_hogp_rep_info *rep,
				   uint8_t err,
				   const uint8_t *data);
static void hogp_ready_cb(struct bt_hogp *hogp);
static void hogp_prep_fail_cb(struct bt_hogp *hogp, int err);
static void hogp_pm_update_cb(struct bt_hogp *hogp);

/* Button handler functions */
static void button_bootmode(void);
static void button_capslock(void);
static void button_capslock_rsp(void);
static void hidc_write_cb(struct bt_hogp *hidc,
			  struct bt_hogp_rep_info *rep,
			  uint8_t err);
static uint8_t capslock_read_cb(struct bt_hogp *hogp,
			     struct bt_hogp_rep_info *rep,
			     uint8_t err,
			     const uint8_t *data);
static void capslock_write_cb(struct bt_hogp *hogp,
			      struct bt_hogp_rep_info *rep,
			      uint8_t err);

/* Discovery callback functions */
static void discovery_completed_cb(struct bt_gatt_dm *dm, void *context);
static void discovery_service_not_found_cb(struct bt_conn *conn, void *context);
static void discovery_error_found_cb(struct bt_conn *conn, int err, void *context);

static const struct bt_gatt_dm_cb discovery_cb = {
	.completed = discovery_completed_cb,
	.service_not_found = discovery_service_not_found_cb,
	.error_found = discovery_error_found_cb,
};

/* HOGP initialization parameters */
static const struct bt_hogp_init_params hogp_init_params = {
	.ready_cb      = hogp_ready_cb,
	.prep_error_cb = hogp_prep_fail_cb,
	.pm_update_cb  = hogp_pm_update_cb
};

/* HOGP callback implementations */
static uint8_t hogp_notify_cb(struct bt_hogp *hogp,
			     struct bt_hogp_rep_info *rep,
			     uint8_t err,
			     const uint8_t *data)
{
	uint8_t size = bt_hogp_rep_size(rep);
	uint8_t i;

	if (!data) {
		return BT_GATT_ITER_STOP;
	}
	printk("Notification, id: %u, size: %u, data:",
	       bt_hogp_rep_id(rep),
	       size);
	for (i = 0; i < size; ++i) {
		printk(" 0x%x", data[i]);
	}
	printk("\n");
	
	// Handle different report types based on Report ID
	uint8_t report_id = bt_hogp_rep_id(rep);
	
	// Parse and forward each report ID independently
	if (size >= 1) {
		/* Send directly to USB for zero latency */
		uint8_t report_with_id[size + 1];
		report_with_id[0] = report_id;
		for (uint8_t i = 0; i < size; i++) {
			report_with_id[i + 1] = data[i];
		}
		
		int ret = hid_int_ep_write(hid_dev, report_with_id, size + 1, NULL);
		if (ret) {
			printk("HID write error, %d", ret);
		} else {
			k_sem_take(&ep_write_sem, K_FOREVER);
			// printk("Report %u sent directly to USB", report_id);
		}
	}
	
	return BT_GATT_ITER_CONTINUE;
}

static uint8_t hogp_boot_mouse_report(struct bt_hogp *hogp,
				     struct bt_hogp_rep_info *rep,
				     uint8_t err,
				     const uint8_t *data)
{
	uint8_t size = bt_hogp_rep_size(rep);

	if (!data) {
		return BT_GATT_ITER_STOP;
	}
	
	printk("Boot mouse report: size=%u, data:", size);
	for (uint8_t i = 0; i < size; i++) {
		printk(" 0x%02x", data[i]);
	}
	printk("\n");
	
	/* Forward boot mouse report directly to USB as Report ID 1 */
	/* Boot reports are always sent as Report ID 1 (buttons + wheel) */
	uint8_t report_with_id[size + 1];
	report_with_id[0] = 1;  // Report ID 1 for boot mouse
	
	/* Copy the raw boot mouse data */
	for (uint8_t i = 0; i < size; i++) {
		report_with_id[i + 1] = data[i];
	}
	
	/* Send directly to USB for zero latency */
	int ret = hid_int_ep_write(hid_dev, report_with_id, size + 1, NULL);
	if (ret) {
		printk("HID write error, %d", ret);
	} else {
		k_sem_take(&ep_write_sem, K_FOREVER);
		printk("Boot mouse report sent directly to USB");
	}
	
	return BT_GATT_ITER_CONTINUE;
}

static uint8_t hogp_boot_kbd_report(struct bt_hogp *hogp,
				   struct bt_hogp_rep_info *rep,
				   uint8_t err,
				   const uint8_t *data)
{
	uint8_t size = bt_hogp_rep_size(rep);
	uint8_t i;

	if (!data) {
		return BT_GATT_ITER_STOP;
	}
	printk("Notification, keyboard boot, size: %u, data:", size);
	for (i = 0; i < size; ++i) {
		printk(" 0x%x", data[i]);
	}
	printk("\n");
	return BT_GATT_ITER_CONTINUE;
}

static void hogp_ready_cb(struct bt_hogp *hogp)
{
	k_work_submit(&hids_ready_work);
}

/* Auto-detect and switch to optimal protocol mode */
/**
 * @brief Auto-detect and switch to optimal HID protocol mode
 * 
 * This function implements automatic protocol mode detection and switching,
 * similar to how operating systems handle HID protocol mode optimization.
 * 
 * Behavior:
 * 1. Detects current protocol mode (BOOT or REPORT)
 * 2. Analyzes device capabilities (BOOT support, REPORT support)
 * 3. Automatically switches to optimal mode:
 *    - If in BOOT mode and REPORT supported → switch to REPORT
 *    - If in REPORT mode but no REPORT support → fallback to BOOT
 *    - If only BOOT supported → stay in BOOT mode
 * 
 * This is called automatically when HID device is ready, and can also
 * be triggered manually via ble_hid_auto_detect_mode().
 */
static void auto_detect_and_switch_mode(void)
{
	enum bt_hids_pm current_mode = bt_hogp_pm_get(&hogp);
	
	printk("Auto-detecting optimal protocol mode...\n");
	printk("Current mode: %s\n", 
	       (current_mode == BT_HIDS_PM_BOOT) ? "BOOT" : "REPORT");
	
	/* Check if device supports REPORT mode */
	bool has_report_support = false;
	struct bt_hogp_rep_info *rep = NULL;
	
	/* Check for any report protocol reports */
	do {
		rep = bt_hogp_rep_next(&hogp, rep);
		if (rep) {
			/* If we have any report protocol reports, device supports REPORT mode */
			has_report_support = true;
			break;
		}
	} while (rep);
	
	/* Also check for boot protocol reports as fallback */
	bool has_boot_support = (hogp.rep_boot.kbd_inp != NULL || 
	                        hogp.rep_boot.mouse_inp != NULL);
	
	printk("Device capabilities: BOOT=%s, REPORT=%s\n",
	       has_boot_support ? "YES" : "NO",
	       has_report_support ? "YES" : "NO");
	
	/* Auto-switch logic (similar to OS behavior) */
	if (current_mode == BT_HIDS_PM_BOOT) {
		if (has_report_support) {
			/* Device supports REPORT mode - switch for better features */
			printk("Switching to REPORT mode for enhanced functionality\n");
			bt_hogp_pm_update(&hogp, K_SECONDS(5));
		} else if (has_boot_support) {
			/* Device only supports BOOT mode */
			printk("Device only supports BOOT mode - staying in BOOT mode\n");
		} else {
			/* No HID reports found */
			printk("Warning: No HID reports found on device\n");
		}
	} else if (current_mode == BT_HIDS_PM_REPORT) {
		if (has_report_support) {
			/* Already in optimal mode */
			printk("Already in optimal REPORT mode\n");
		} else {
			/* REPORT mode but no report support - fallback to BOOT */
			printk("REPORT mode but no report support - switching to BOOT mode\n");
			bt_hogp_pm_update(&hogp, K_SECONDS(5));
		}
	}
}

static void hids_on_ready(struct k_work *work)
{
	int err;
	struct bt_hogp_rep_info *rep = NULL;

	ARG_UNUSED(work);

	printk("HIDS is ready\n");

	/* Auto-detect and switch to optimal protocol mode */
	auto_detect_and_switch_mode();

	/* Subscribe to all reports */
	do {
		rep = bt_hogp_rep_next(&hogp, rep);
		if (rep) {
			err = bt_hogp_rep_subscribe(&hogp, rep, hogp_notify_cb);
			if (err) {
				printk("Subscribe failed, err: %d\n", err);
			}
		}
	} while (rep);

	/* Subscribe to boot reports if in boot mode */
	if (bt_hogp_pm_get(&hogp) == BT_HIDS_PM_BOOT) {
		if (hogp.rep_boot.kbd_inp) {
			printk("Subscribe to boot keyboard report\n");
			err = bt_hogp_rep_subscribe(&hogp,
							   hogp.rep_boot.kbd_inp,
							   hogp_boot_kbd_report);
			if (err) {
				printk("Subscribe error (%d)\n", err);
			}
		}
		if (hogp.rep_boot.mouse_inp) {
			printk("Subscribe to boot mouse report\n");
			err = bt_hogp_rep_subscribe(&hogp,
							   hogp.rep_boot.mouse_inp,
							   hogp_boot_mouse_report);
			if (err) {
				printk("Subscribe error (%d)\n", err);
			}
		}
	} else {
		printk("In REPORT mode - using report protocol reports only\n");
	}

	hid_ready = true;
}

static void hogp_prep_fail_cb(struct bt_hogp *hogp, int err)
{
	printk("HOGP prepare failed, err: %d\n", err);
}

static void hogp_pm_update_cb(struct bt_hogp *hogp)
{
	enum bt_hids_pm pm = bt_hogp_pm_get(hogp);

	printk("HOGP PM update: %d\n", pm);
}

/* Button handler functions */
static void button_bootmode(void)
{
	enum bt_hids_pm pm = bt_hogp_pm_get(&hogp);
	enum bt_hids_pm new_pm = ((pm == BT_HIDS_PM_BOOT) ? BT_HIDS_PM_REPORT : BT_HIDS_PM_BOOT);

	printk("Switching HIDS PM from %d to %d\n", pm, new_pm);
	bt_hogp_pm_update(&hogp, K_SECONDS(5));
}

static void hidc_write_cb(struct bt_hogp *hidc,
			  struct bt_hogp_rep_info *rep,
			  uint8_t err)
{
	printk("HOGP write completed\n");
}

static void button_capslock(void)
{
	if (!hogp.rep_boot.kbd_out) {
		printk("HID device does not have Keyboard OUT report\n");
		return;
	}

	capslock_state = capslock_state ? 0 : 1;
	uint8_t data = capslock_state ? 0x02 : 0;
	int err = bt_hogp_rep_write_wo_rsp(&hogp, hogp.rep_boot.kbd_out,
				       &data, sizeof(data),
				       hidc_write_cb);

	if (err) {
		printk("Keyboard data write error (err: %d)\n", err);
		return;
	}
	printk("Caps lock send (val: 0x%x)\n", data);
}

static uint8_t capslock_read_cb(struct bt_hogp *hogp,
			     struct bt_hogp_rep_info *rep,
			     uint8_t err,
			     const uint8_t *data)
{
	if (err) {
		printk("Capslock read error (err: %u)\n", err);
		return BT_GATT_ITER_STOP;
	}
	if (!data) {
		printk("Capslock read - no data\n");
		return BT_GATT_ITER_STOP;
	}
	printk("Received data (size: %u, data[0]: 0x%x)\n",
	       bt_hogp_rep_size(rep), data[0]);

	return BT_GATT_ITER_STOP;
}

static void capslock_write_cb(struct bt_hogp *hogp,
			      struct bt_hogp_rep_info *rep,
			      uint8_t err)
{
	int ret;

	printk("Capslock write result: %u\n", err);

	ret = bt_hogp_rep_read(hogp, rep, capslock_read_cb);
	if (ret) {
		printk("Cannot read capslock value (err: %d)\n", ret);
	}
}

static void button_capslock_rsp(void)
{
	if (!bt_hogp_ready_check(&hogp)) {
		printk("HID device not ready\n");
		return;
	}
	if (!hogp.rep_boot.kbd_out) {
		printk("HID device does not have Keyboard OUT report\n");
		return;
	}
	int err;
	uint8_t data;

	capslock_state = capslock_state ? 0 : 1;
	data = capslock_state ? 0x02 : 0;
	err = bt_hogp_rep_write(&hogp, hogp.rep_boot.kbd_out, capslock_write_cb,
				&data, sizeof(data));
	if (err) {
		printk("Keyboard data write error (err: %d)\n", err);
		return;
	}
	printk("Caps lock send using write with response (val: 0x%x)\n", data);
}

/* Public API implementations */
int ble_hid_init(void)
{
	LOG_INF("Initializing BLE HID...");
	
	bt_hogp_init(&hogp, &hogp_init_params);
	
	LOG_INF("✓ BLE HID initialized");
	return 0;
}

void ble_hid_discovery_complete(void)
{
	LOG_INF("HID discovery completed - calling ready callback");
	if (ready_callback) {
		ready_callback();
	}
}

int ble_hid_discover(struct bt_conn *conn)
{
	int err;
	
	LOG_INF("Starting HID service discovery...");
	
	err = bt_gatt_dm_start(conn, BT_UUID_HIDS, &discovery_cb, &hogp);
	if (err) {
		printk("Could not start discovery (err %d)\n", err);
		return err;
	}
	
	return 0;
}

bool ble_hid_is_ready(void)
{
	return hid_ready;
}

int ble_hid_send_report(const uint8_t *data, uint16_t len)
{
	if (!hid_ready) {
		return -EAGAIN;
	}
	
	// Implementation would go here if needed
	return 0;
}

struct bt_hogp *ble_hid_get_hogp(void)
{
	return &hogp;
}

uint8_t (*ble_hid_get_notify_cb(void))(struct bt_hogp *, struct bt_hogp_rep_info *, uint8_t, const uint8_t *)
{
	return hogp_notify_cb;
}

uint8_t (*ble_hid_get_boot_mouse_cb(void))(struct bt_hogp *, struct bt_hogp_rep_info *, uint8_t, const uint8_t *)
{
	return hogp_boot_mouse_report;
}

uint8_t (*ble_hid_get_boot_kbd_cb(void))(struct bt_hogp *, struct bt_hogp_rep_info *, uint8_t, const uint8_t *)
{
	return hogp_boot_kbd_report;
}

void ble_hid_handle_buttons(uint32_t button_state, uint32_t has_changed)
{
	uint32_t button = button_state & has_changed;

	if (button & KEY_BOOTMODE_MASK) {
		button_bootmode();
	}

	if (button & KEY_CAPSLOCK_MASK) {
		button_capslock();
	}

	if (button & KEY_CAPSLOCK_RSP_MASK) {
		button_capslock_rsp();
	}

	/* Auto-detection trigger (if we had a button) */
	/* This would be triggered by a physical button if available */
	/* For now, we can call this manually via ble_hid_auto_detect_mode() */
}

int ble_hid_register_data_received_cb(ble_hid_data_received_cb_t cb)
{
	data_received_callback = cb;
	return 0;
}

int ble_hid_register_ready_cb(ble_hid_ready_cb_t cb)
{
	ready_callback = cb;
	return 0;
}

/* Manual trigger for auto-detection (for testing) */
int ble_hid_auto_detect_mode(void)
{
	if (!hid_ready) {
		printk("HID device not ready for mode detection\n");
		return -EAGAIN;
	}
	
	printk("Manual trigger: Auto-detecting protocol mode\n");
	auto_detect_and_switch_mode();
	return 0;
}

/* Discovery callback implementations */
static void discovery_completed_cb(struct bt_gatt_dm *dm, void *context)
{
	struct bt_hogp *hogp = context;
	int err;

	printk("The discovery procedure succeeded\n");

	bt_gatt_dm_data_print(dm);

	err = bt_hogp_handles_assign(dm, hogp);
	if (err) {
		printk("Could not assign HOGP handles (err %d)\n", err);
		return;
	}

	printk("HOGP ready\n");
}

static void discovery_service_not_found_cb(struct bt_conn *conn, void *context)
{
	printk("The service could not be found during the discovery\n");
}

static void discovery_error_found_cb(struct bt_conn *conn, int err, void *context)
{
	printk("The discovery procedure failed with %d\n", err);
}
```

## src/ble_hid.h
```c
/*
 * Copyright (c) 2025 Robert Dale Smith
 * Copyright (c) 2025 Augmental Tech
 *
 * SPDX-License-Identifier: Apache-2.0
 */

#ifndef BLE_HID_H
#define BLE_HID_H

#include <zephyr/bluetooth/bluetooth.h>
#include <zephyr/bluetooth/conn.h>
#include <bluetooth/services/hogp.h>

#ifdef __cplusplus
extern "C" {
#endif

/**
 * @brief Initialize the BLE HID module
 * 
 * This function initializes the HOGP client and sets up HID-related callbacks.
 * 
 * @return 0 on success, negative error code on failure
 */
int ble_hid_init(void);

/**
 * @brief Signal that HID discovery is complete
 * 
 * This function is called by the central module when HID service discovery
 * is complete, and it triggers the ready callback.
 */
void ble_hid_discovery_complete(void);

/**
 * @brief Discover HID services on a connected device
 * 
 * @param conn The BLE connection to discover services on
 * @return 0 on success, negative error code on failure
 */
int ble_hid_discover(struct bt_conn *conn);

/**
 * @brief Check if HID is ready for use
 * 
 * @return true if HID is ready, false otherwise
 */
bool ble_hid_is_ready(void);

/**
 * @brief Send a HID report
 * 
 * @param data The report data to send
 * @param len The length of the report data
 * @return 0 on success, negative error code on failure
 */
int ble_hid_send_report(const uint8_t *data, uint16_t len);

/**
 * @brief Get the HOGP instance
 * 
 * @return Pointer to the HOGP instance
 */
struct bt_hogp *ble_hid_get_hogp(void);

/**
 * @brief Get the HOGP notify callback function
 * 
 * @return Pointer to the HOGP notify callback function
 */
uint8_t (*ble_hid_get_notify_cb(void))(struct bt_hogp *, struct bt_hogp_rep_info *, uint8_t, const uint8_t *);

/**
 * @brief Get the HOGP boot mouse callback function
 * 
 * @return Pointer to the HOGP boot mouse callback function
 */
uint8_t (*ble_hid_get_boot_mouse_cb(void))(struct bt_hogp *, struct bt_hogp_rep_info *, uint8_t, const uint8_t *);

/**
 * @brief Get the HOGP boot keyboard callback function
 * 
 * @return Pointer to the HOGP boot keyboard callback function
 */
uint8_t (*ble_hid_get_boot_kbd_cb(void))(struct bt_hogp *, struct bt_hogp_rep_info *, uint8_t, const uint8_t *);

/**
 * @brief Handle button events for HID functionality
 * 
 * @param button_state The button state
 * @param has_changed Which buttons have changed
 */
void ble_hid_handle_buttons(uint32_t button_state, uint32_t has_changed);

/* Callback function types */
typedef void (*ble_hid_data_received_cb_t)(const uint8_t *data, uint16_t len);
typedef void (*ble_hid_ready_cb_t)(void);

/**
 * @brief Register data received callback
 *
 * @param cb Callback function for data received events
 * @return 0 on success, negative error code on failure
 */
int ble_hid_register_data_received_cb(ble_hid_data_received_cb_t cb);

/**
 * @brief Register ready callback
 *
 * @param cb Callback function for ready events
 * @return 0 on success, negative error code on failure
 */
int ble_hid_register_ready_cb(ble_hid_ready_cb_t cb);

/**
 * @brief Manually trigger auto-detection and mode switching
 *
 * This function manually triggers the automatic protocol mode detection
 * and switching logic, similar to how operating systems handle HID
 * protocol mode optimization.
 *
 * @return 0 on success, negative error code on failure
 */
int ble_hid_auto_detect_mode(void);

#ifdef __cplusplus
}
#endif

#endif /* BLE_HID_H */ 
```

## src/ble_transport.c
```c
/*
 * Copyright (c) 2025 Robert Dale Smith
 * Copyright (c) 2025 Augmental Tech
 *
 * SPDX-License-Identifier: Apache-2.0
 */

#include <zephyr/types.h>
#include <stddef.h>
#include <errno.h>
#include <zephyr/kernel.h>
#include <zephyr/sys/printk.h>

#include <zephyr/bluetooth/bluetooth.h>
#include <zephyr/bluetooth/hci.h>
#include <zephyr/bluetooth/conn.h>
#include <zephyr/bluetooth/uuid.h>
#include <zephyr/bluetooth/gatt.h>
#include <bluetooth/gatt_dm.h>
#include <zephyr/sys/byteorder.h>
#include <bluetooth/scan.h>
#include <bluetooth/services/hogp.h>
#include <dk_buttons_and_leds.h>

#include <zephyr/settings/settings.h>

#include <zephyr/logging/log.h>
#include <zephyr/usb/usb_device.h>
#include <zephyr/usb/class/usb_hid.h>

#include "ble_hid.h"
#include "ble_central.h"
#include "ble_transport.h"

/* Forward declarations for direct USB access */
extern const struct device *hid_dev;
extern struct k_sem ep_write_sem;

LOG_MODULE_REGISTER(ble_transport, LOG_LEVEL_INF);

/* Give controller time to settle before starting scan */
static const int SCAN_DELAY_MS = 1000;

/* USB HID callback */
static usb_hid_send_cb_t usb_hid_send_callback = NULL;

/* HID Bridge state */
static bool hid_client_ready = false;
static bool bridging_started = false;

/* Future NUS Bridge state */
static ble_data_callback_t nus_data_callback = NULL;
static ble_ready_callback_t nus_ready_callback = NULL;
static bool nus_client_ready = false;

/* Internal callback functions */
static void ble_hid_data_received_cb(const uint8_t *data, uint16_t len);
static void ble_hid_ready_cb(void);
static void ble_central_connected_cb(struct bt_conn *conn);
static void ble_central_disconnected_cb(struct bt_conn *conn, uint8_t reason);
static void button_handler(uint32_t button_state, uint32_t has_changed);

/* Forward declare the work item */
static struct k_work_delayable delayed_scan_work;

/* Delayed scan start work (following HID Remapper pattern) */
static void delayed_scan_start_work_fn(struct k_work *work)
{
	int err;
	
	printk("=== STARTING DELAYED SCAN WORK ===\n");
	LOG_INF("Starting delayed BLE scan work...");
	
	/* Setup scan filters like HID Remapper does */
	printk("=== SETTING UP SCAN FILTERS ===\n");
	err = ble_central_setup_scan_filters();
	if (err) {
		LOG_ERR("Scan filter setup failed (err %d)", err);
		printk("=== SCAN FILTER SETUP FAILED ===\n");
		return;
	}
	
	/* Start scan like HID Remapper does */
	printk("=== STARTING SCAN (HID REMAPPER STYLE) ===\n");
	err = bt_scan_start(BT_SCAN_TYPE_SCAN_PASSIVE);
	if (err == 0) {
		LOG_INF("Scanning started successfully");
		printk("=== SCAN STARTED SUCCESSFULLY ===\n");
	} else if (err == -EALREADY) {
		LOG_INF("Scan already in progress");
		printk("=== SCAN ALREADY RUNNING ===\n");
	} else {
		LOG_ERR("bt_scan_start failed (err %d)", err);
		printk("=== SCAN START FAILED: err=%d ===\n", err);
		
		/* Retry if busy */
		if (err == -EAGAIN || err == -EBUSY) {
			LOG_WRN("Scanner busy, will retry in 1 second");
			k_work_reschedule(&delayed_scan_work, K_MSEC(1000));
		}
	}
}

static K_WORK_DELAYABLE_DEFINE(delayed_scan_work, delayed_scan_start_work_fn);

/* BLE Transport initialization */
int ble_transport_init(void)
{
	int err;

	printk("=== BLE TRANSPORT INIT START ===\n");

	/* Register BLE Central callbacks */
	ble_central_register_connected_cb(ble_central_connected_cb);
	ble_central_register_disconnected_cb(ble_central_disconnected_cb);

	/* Initialize BLE Central */
	err = ble_central_init();
	if (err != 0) {
		LOG_ERR("ble_central_init failed (err %d)", err);
		return err;
	}

	/* Register HID Client callbacks */
	ble_hid_register_data_received_cb(ble_hid_data_received_cb);
	ble_hid_register_ready_cb(ble_hid_ready_cb);

	/* Initialize HID client */
	err = ble_hid_init();
	if (err != 0) {
		LOG_ERR("ble_hid_init failed (err %d)", err);
		return err;
	}

	/* Enable Bluetooth FIRST like HID Remapper does */
	printk("=== ENABLING BLUETOOTH (HID REMAPPER ORDER) ===\n");
	err = bt_enable(NULL);
	if (err) {
			LOG_ERR("Bluetooth init failed (err %d)", err);
			printk("=== BLUETOOTH ENABLE FAILED ===\n");
			return err;
	}

	printk("=== BLUETOOTH ENABLED SUCCESSFULLY ===\n");

	/* Register auth callbacks AFTER bt_enable */
	err = ble_central_init_auth_callbacks();
	if (err != 0) {
			LOG_ERR("ble_central_init_auth_callbacks failed (err %d)", err);
			return err;
	}

	/* Initialize BLE Central callbacks */
	err = ble_central_init_callbacks();
	if (err != 0) {
			LOG_ERR("ble_central_init_callbacks failed (err %d)", err);
			return err;
	}

	/* Initialize settings AFTER bt_enable - EXACTLY like HID Remapper */
	if (IS_ENABLED(CONFIG_SETTINGS)) {
			printk("=== INITIALIZING SETTINGS AFTER BT_ENABLE ===\n");
			err = settings_subsys_init();
			if (err) {
					LOG_ERR("Settings subsys init failed (err %d)", err);
					printk("=== SETTINGS INIT FAILED ===\n");
					return err;
			}
			
			settings_load();
			LOG_INF("Settings loaded AFTER BT init (HID Remapper order)");
			printk("=== SETTINGS LOADED AFTER BT INIT ===\n");
	}

	/* HID Remapper doesn't enable bondable mode */
	printk("=== BONDING DISABLED (LIKE HID REMAPPER) ===\n");

	/* Check if we have an identity address, if not create one */
	bt_addr_le_t addrs[CONFIG_BT_ID_MAX];
	size_t count = CONFIG_BT_ID_MAX;
	bt_id_get(addrs, &count);
	printk("=== BT IDENTITY COUNT AFTER INIT: %d ===\n", count);

	if (count == 0) {
			printk("=== NO IDENTITY ADDRESS - CREATING ONE ===\n");
			int identity_id = bt_id_create(NULL, NULL);
			if (identity_id < 0) {
					LOG_ERR("Failed to create BT identity (err %d)", identity_id);
					printk("=== IDENTITY CREATION FAILED ===\n");
					return identity_id;
			}
			printk("=== IDENTITY CREATED: ID %d ===\n", identity_id);
			
			/* Check count again */
			count = CONFIG_BT_ID_MAX;
			bt_id_get(addrs, &count);
			printk("=== NEW BT IDENTITY COUNT: %d ===\n", count);
	}

	LOG_INF("BLE stack fully configured and ready");

	/* Initialize scan after Bluetooth is enabled (following HID Remapper pattern) */
	err = ble_central_init_scan();
	if (err) {
			LOG_ERR("BLE scan init failed (err %d)", err);
			printk("=== SCAN INIT FAILED ===\n");
			return err;
	}
	printk("=== SCAN INITIALIZED ===\n");

	err = dk_buttons_init(button_handler);
	if (err) {
		LOG_ERR("Failed to initialize buttons (err %d)", err);
		return err;
	}

	/* Schedule delayed scan start EXACTLY like HID Remapper does */
	k_work_reschedule(&delayed_scan_work, K_MSEC(SCAN_DELAY_MS));
	LOG_INF("Scheduled delayed scan start in %d ms (HID Remapper pattern)", SCAN_DELAY_MS);
	printk("=== SCAN SCHEDULED FOR %d ms (HID REMAPPER PATTERN) ===\n", SCAN_DELAY_MS);

	LOG_INF("BLE Transport initialized successfully");
	printk("=== BLE TRANSPORT INIT COMPLETE ===\n");
	return 0;
}

/* Transport registration functions */
int ble_transport_register_usb_hid_callback(usb_hid_send_cb_t cb)
{
	usb_hid_send_callback = cb;
	return 0;
}

int ble_transport_start_bridging(void)
{
	bridging_started = true;
	LOG_INF("BLE Transport bridging started");
	return 0;
}

int ble_transport_send_hid_data(const uint8_t *data, uint16_t len)
{
	if (!hid_client_ready) {
		LOG_WRN("HID client not ready");
		return -ENOTCONN;
	}

	LOG_INF("BLE Transport sending %d bytes to HID", len);
	int err = ble_hid_send_report(data, len);
	if (err) {
		LOG_ERR("BLE Transport send failed: %d", err);
	} else {
		LOG_INF("BLE Transport send successful");
	}
	return err;
}

bool ble_transport_is_hid_ready(void)
{
	return hid_client_ready;
}

/* Future NUS Transport functions */
int ble_transport_register_nus_data_callback(ble_data_callback_t cb)
{
	nus_data_callback = cb;
	return 0;
}

int ble_transport_register_nus_ready_callback(ble_ready_callback_t cb)
{
	nus_ready_callback = cb;
	return 0;
}

int ble_transport_send_nus_data(const uint8_t *data, uint16_t len)
{
	if (!nus_client_ready) {
		LOG_WRN("NUS client not ready");
		return -ENOTCONN;
	}

	// TODO: Implement NUS client send when NUS bridge is added
	return -ENOSYS;
}

bool ble_transport_is_nus_ready(void)
{
	return nus_client_ready;
}

/* Internal callback functions */
static void ble_hid_data_received_cb(const uint8_t *data, uint16_t len)
{
	LOG_INF("HID data received: %d bytes", len);

	// Bridge HID data directly to USB HID
	if (usb_hid_send_callback) {
		usb_hid_send_callback(data, len);
	}
}

static void ble_hid_ready_cb(void)
{
	LOG_INF("HID client ready - service discovery complete");
	hid_client_ready = true;
	LOG_INF("HID client ready - bridge operational");
}

static void ble_central_connected_cb(struct bt_conn *conn)
{
	LOG_INF("BLE Central connected - starting setup");
}

static void ble_central_disconnected_cb(struct bt_conn *conn, uint8_t reason)
{
	ARG_UNUSED(conn);
	ARG_UNUSED(reason);

	// Reset ready states
	hid_client_ready = false;
	nus_client_ready = false;

	LOG_INF("BLE Central disconnected - resetting bridge states");
}

/* Button handler for transport layer */
static void button_handler(uint32_t button_state, uint32_t has_changed)
{
	/* Handle BLE Central button events (pairing) */
	ble_central_handle_buttons(button_state, has_changed);

	/* Handle HID-related button events */
	ble_hid_handle_buttons(button_state, has_changed);
}
```
