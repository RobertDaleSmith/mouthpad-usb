## CMakeLists.txt
```
cmake_minimum_required(VERSION 3.20.0)
find_package(Zephyr REQUIRED HINTS $ENV{ZEPHYR_BASE})
project(mouthpad_bridge)

target_sources(app PRIVATE
  src/ble.c
  src/usb.c
  src/main.c
)
```

## Kconfig
```
#
# Copyright (c) 2024 Nordic Semiconductor
#
# SPDX-License-Identifier: LicenseRef-Nordic-5-Clause
#

source "Kconfig.zephyr"

config SETTINGS
	default y

config ZMS
	default y if (SOC_FLASH_NRF_RRAM || SOC_FLASH_NRF_MRAM)

config NVS
	default y if !(SOC_FLASH_NRF_RRAM || SOC_FLASH_NRF_MRAM)
```

## west.yml
```
manifest:
  remotes:
    - name: nordic
      url-base: https://github.com/nordicsemi
    - name: zephyrproject-rtos
      url-base: https://github.com/zephyrproject-rtos

  projects:
    - name: sdk-nrf
      remote: nordic
      revision: main
      path: nrf
      west-commands: scripts/west-commands.yml

    - name: zephyr
      remote: zephyrproject-rtos
      revision: main
      path: zephyr

    - name: nrfxlib
      remote: nordic
      revision: main
      path: nrfxlib

    - name: bootloader
      remote: nordic
      revision: main
      path: bootloader

    - name: mouthpad_usb
      path: app
      revision: main 
```

## prj.conf
```kconfig
#
# Copyright (c) 2019 Nordic Semiconductor ASA
#
# SPDX-License-Identifier: LicenseRef-Nordic-5-Clause
#
CONFIG_NCS_SAMPLES_DEFAULTS=y

# BLE Central
CONFIG_BT=y
CONFIG_BT_CENTRAL=y
CONFIG_BT_SMP=y
CONFIG_BT_ATT_TX_COUNT=5
CONFIG_BT_GATT_CLIENT=y
CONFIG_BT_GATT_DM=y
CONFIG_HEAP_MEM_POOL_SIZE=2048
CONFIG_BT_HOGP=y

CONFIG_BT_SCAN=y
CONFIG_BT_SCAN_FILTER_ENABLE=y
CONFIG_BT_SCAN_UUID_CNT=1
CONFIG_BT_PRIVACY=y

CONFIG_MAIN_STACK_SIZE=2048
CONFIG_SYSTEM_WORKQUEUE_STACK_SIZE=2048

CONFIG_BT_SETTINGS=y
CONFIG_FLASH=y
CONFIG_FLASH_PAGE_LAYOUT=y
CONFIG_FLASH_MAP=y

CONFIG_DK_LIBRARY=y

# USB HID
CONFIG_USB_DEVICE_STACK=y
CONFIG_USB_DEVICE_HID=y
CONFIG_USB_DEVICE_PRODUCT="USBMouthPad"
CONFIG_USB_DEVICE_PID=0xEEEE
CONFIG_USB_DEVICE_VID=0x1915

CONFIG_USB_DEVICE_INITIALIZE_AT_BOOT=n

CONFIG_LOG=y
CONFIG_USB_DRIVER_LOG_LEVEL_ERR=y
CONFIG_USB_DEVICE_LOG_LEVEL_ERR=y

CONFIG_GPIO=y
CONFIG_INPUT=y
CONFIG_INPUT_MODE_SYNCHRONOUS=y

# Console & Logging
CONFIG_PRINTK=y
CONFIG_LOG=y
CONFIG_LOG_MODE_IMMEDIATE=y
```

## src/main.c
```c
/*
 * Copyright (c) 2025 Robert Dale Smith
 * Copyright (c) 2025 Augmental Tech
 *
 * SPDX-License-Identifier: Apache-2.0
 */

#include <zephyr/kernel.h>
#include <zephyr/logging/log.h>
#include "ble.h"
#include "usb.h"
#include "virtual_mouse.h"

LOG_MODULE_REGISTER(main, LOG_LEVEL_INF);

int main(void) {
    LOG_INF("MouthPad^USB Bridge Started");

    // Initialize virtual mouse first
    if (virtual_mouse_init() != 0) {
        LOG_ERR("Failed to initialize virtual mouse");
        return -1;
    }

    ble_init();
    usb_init();

    return 0;
}
```

## src/ble.h
```c
#ifndef BLE_H
#define BLE_H

#include <zephyr/bluetooth/bluetooth.h>
#include <zephyr/bluetooth/conn.h>
#include <bluetooth/services/hogp.h>

#ifdef __cplusplus
extern "C" {
#endif

/**
 * @brief Initialize the BLE stack and start scanning for HID devices
 * 
 * This function initializes the Bluetooth stack, sets up scanning for HID devices,
 * configures authentication callbacks, and starts the scanning process.
 * 
 * @return 0 on success, negative error code on failure
 */
int ble_init(void);

#ifdef __cplusplus
}
#endif

#endif /* BLE_H */
```

## src/ble_config.h
```c
#ifndef BLE_CONFIG_H
#define BLE_CONFIG_H

// BLE Device Configuration
// Uncomment and modify these to target a specific device

// Option 1: Target by MAC address (most reliable for specific device)
// #define TARGET_DEVICE_ADDR "AA:BB:CC:DD:EE:FF"

// Option 2: Target by device name (less reliable, but easier)
// #define TARGET_DEVICE_NAME "MyMouse"

// Option 3: Auto-connect to MouthPad devices (RECOMMENDED for distribution)
#define AUTO_CONNECT_MOUTHPAD

// Option 4: Auto-connect to any HID+UART device (fallback)
// #define AUTO_CONNECT_HID_UART

// Option 5: Specific device configurations
// Uncomment one of these for your specific device:

// For RDSMouthPad device (for testing)
// #define TARGET_DEVICE_ADDR "F0:1A:5F:52:2A:3E"
// #define TARGET_DEVICE_NAME "RDSMouthPad"

// Connection preferences
#define CONNECTION_TIMEOUT_MS 10000  // 10 seconds
#define MAX_CONNECTION_ATTEMPTS 3

// Scan preferences
#define SCAN_DURATION_SECONDS 30     // How long to scan before restarting

#endif // BLE_CONFIG_H 
```

## src/ble_hid_c.c
```c
// BLE HID Central implementation
#include "ble_hid_c.h"
#include <zephyr/logging/log.h>
#include <zephyr/bluetooth/bluetooth.h>
#include <zephyr/bluetooth/gatt.h>
#include <zephyr/bluetooth/hci.h>
#include <zephyr/bluetooth/conn.h>
#include <zephyr/bluetooth/uuid.h>

LOG_MODULE_REGISTER(ble_hid_c, LOG_LEVEL_INF);

// Use the standard HID UUIDs from Zephyr
// HID Service UUID is already defined as BT_UUID_HIDS_VAL (0x1812)
// HID Report Characteristic UUID is already defined as BT_UUID_HIDS_REPORT_VAL (0x2a4d)

static ble_hid_report_callback_t report_callback = NULL;
static ble_hid_state_t current_state = BLE_HID_STATE_DISCONNECTED;
static ble_hid_device_t current_device = {0};
static char target_name[32] = "";
static bt_addr_le_t target_address = {0};
static bool target_address_set = false;

// Static allocation for GATT discovery parameters
static struct bt_gatt_discover_params discover_params;

// Service discovery timeout timer
static struct k_timer discovery_timeout_timer;
static void discovery_timeout_handler(struct k_timer *dummy)
{
    LOG_WRN("HID service discovery timeout - aborting discovery");
    // Note: bt_gatt_discover_cancel is not available in this Zephyr version
    // The discovery will timeout naturally
}

// Connection parameters removed - main.c handles connection parameters
// static const struct bt_le_conn_param conservative_conn_param = { ... };

// Forward declaration of notification callback
static uint8_t hid_notify_callback(struct bt_conn *conn,
                                  struct bt_gatt_subscribe_params *params,
                                  const void *data, uint16_t length);

// GATT discovery callbacks
static uint8_t discover_func(struct bt_conn *conn, const struct bt_gatt_attr *attr,
                            struct bt_gatt_discover_params *params)
{
    if (!attr) {
        LOG_INF("HID service discovery complete");
        k_timer_stop(&discovery_timeout_timer);
        return BT_GATT_ITER_STOP;
    }

    const struct bt_gatt_service_val *gatt_service = attr->user_data;
    
    if (bt_uuid_cmp(params->uuid, BT_UUID_DECLARE_16(BT_UUID_HIDS_VAL)) == 0) {
        LOG_INF("HID service found at handle %u", attr->handle);
        current_device.hid_service_handle = attr->handle;
        
        // Start discovering HID report characteristic
        struct bt_gatt_discover_params *discover_params = 
            (struct bt_gatt_discover_params *)params;
        discover_params->uuid = BT_UUID_DECLARE_16(BT_UUID_HIDS_REPORT_VAL);
        discover_params->start_handle = attr->handle + 1;
        discover_params->end_handle = gatt_service->end_handle;
        discover_params->type = BT_GATT_DISCOVER_CHARACTERISTIC;
        
        return bt_gatt_discover(conn, discover_params);
    }
    
    if (bt_uuid_cmp(params->uuid, BT_UUID_DECLARE_16(BT_UUID_HIDS_REPORT_VAL)) == 0) {
        const struct bt_gatt_chrc *chrc = attr->user_data;
        LOG_INF("HID report characteristic found at handle %u", attr->handle);
        current_device.hid_report_handle = chrc->value_handle;
        current_device.hid_report_cccd_handle = chrc->value_handle + 1;
        
        // Enable notifications
        struct bt_gatt_subscribe_params *subscribe_params = 
            (struct bt_gatt_subscribe_params *)params;
        subscribe_params->value_handle = chrc->value_handle;
        subscribe_params->ccc_handle = chrc->value_handle + 1;
        subscribe_params->value = BT_GATT_CCC_NOTIFY;
        subscribe_params->notify = hid_notify_callback;
        
        return bt_gatt_subscribe(conn, subscribe_params);
    }
    
    return BT_GATT_ITER_STOP;
}

// HID notification callback
static uint8_t hid_notify_callback(struct bt_conn *conn,
                                  struct bt_gatt_subscribe_params *params,
                                  const void *data, uint16_t length)
{
    if (!data) {
        LOG_INF("HID notifications disabled");
        current_device.notifications_enabled = false;
        return BT_GATT_ITER_STOP;
    }
    
    LOG_INF("HID report received: %d bytes", length);
    current_device.notifications_enabled = true;
    
    // Log the raw data as hex for debugging
    LOG_INF("HID: Raw data: ");
    for (int i = 0; i < length && i < 16; i++) {
        LOG_INF("%02X ", ((uint8_t *)data)[i]);
    }
    if (length > 16) {
        LOG_INF("...");
    }
    LOG_INF("");
    
    if (report_callback) {
        report_callback((const uint8_t *)data, length);
    }
    
    return BT_GATT_ITER_CONTINUE;
}

// Connection callback - removed (now handled by main.c)
// static void connected(struct bt_conn *conn, uint8_t err) { ... }

// Disconnect callback - removed (now handled by main.c)
// static void disconnected(struct bt_conn *conn, uint8_t reason) { ... }

// Connection callbacks removed - main.c handles connections
// static struct bt_conn_cb conn_callbacks = {
//     .connected = connected,
//     .disconnected = disconnected,
// };

// Scan callback - removed connection creation logic
// Connection is now handled by main.c
static void scan_cb(const bt_addr_le_t *addr, int8_t rssi, uint8_t adv_type,
                   struct net_buf_simple *buf)
{
    char addr_str[BT_ADDR_LE_STR_LEN];
    bt_addr_le_to_str(addr, addr_str, sizeof(addr_str));
    
    LOG_INF("Found device: %s", addr_str);
    
    // Check if this is our target device
    if (target_address_set && bt_addr_le_cmp(addr, &target_address) == 0) {
        LOG_INF("Found target HID device");
        // Connection will be handled by main.c
    }
}

void ble_hid_c_init(ble_hid_report_callback_t callback)
{
    report_callback = callback;
    // Connection callbacks are now handled by main.c
    // bt_conn_cb_register(&conn_callbacks);
    
    // Initialize discovery timeout timer
    k_timer_init(&discovery_timeout_timer, discovery_timeout_handler, NULL);
    
    LOG_INF("BLE HID client initialized");
}

void ble_hid_c_start_scan(void)
{
    current_state = BLE_HID_STATE_DISCOVERING;
    LOG_INF("Starting HID device scan");
    
    struct bt_le_scan_param scan_param = {
        .type = BT_LE_SCAN_TYPE_PASSIVE,
        .options = BT_LE_SCAN_OPT_NONE,
        .interval = BT_GAP_SCAN_FAST_INTERVAL,
        .window = BT_GAP_SCAN_FAST_WINDOW,
    };
    
    bt_le_scan_start(&scan_param, scan_cb);
}

void ble_hid_c_stop_scan(void)
{
    bt_le_scan_stop();
    LOG_INF("HID device scan stopped");
}

// Connection function removed - main.c handles connections
// bool ble_hid_c_connect(const bt_addr_le_t *addr) { ... }

void ble_hid_c_disconnect(void)
{
    if (current_device.conn) {
        bt_conn_disconnect(current_device.conn, BT_HCI_ERR_REMOTE_USER_TERM_CONN);
    }
}

ble_hid_state_t ble_hid_c_get_state(void)
{
    return current_state;
}

bool ble_hid_c_is_connected(void)
{
    return current_state == BLE_HID_STATE_CONNECTED;
}

const ble_hid_device_t* ble_hid_c_get_device(void)
{
    return &current_device;
}

void ble_hid_c_on_ble_evt(struct bt_conn *conn, uint8_t evt_type, struct bt_gatt_attr *attr, void *buf)
{
    // Handle BLE events if needed
}

void ble_hid_c_set_target_name(const char *name)
{
    strncpy(target_name, name, sizeof(target_name) - 1);
    target_name[sizeof(target_name) - 1] = '\0';
}

void ble_hid_c_set_target_address(const bt_addr_le_t *addr)
{
    if (addr) {
        bt_addr_le_copy(&target_address, addr);
        target_address_set = true;
    }
}

// Function to handle connection established by main.c
void ble_hid_c_on_connected(struct bt_conn *conn)
{
    LOG_INF("HID client notified of connection");
    current_device.conn = bt_conn_ref(conn);
    current_state = BLE_HID_STATE_CONNECTED;
    
    // Start service discovery with timeout
    discover_params.uuid = BT_UUID_DECLARE_16(BT_UUID_HIDS_VAL);
    discover_params.start_handle = BT_ATT_FIRST_ATTRIBUTE_HANDLE;
    discover_params.end_handle = BT_ATT_LAST_ATTRIBUTE_HANDLE;
    discover_params.type = BT_GATT_DISCOVER_PRIMARY;
    discover_params.func = discover_func;
    
    int discover_err = bt_gatt_discover(conn, &discover_params);
    if (discover_err) {
        LOG_ERR("Failed to start HID service discovery: %d", discover_err);
        return;
    }
    
    // Start discovery timeout timer (5 seconds)
    k_timer_start(&discovery_timeout_timer, K_SECONDS(5), K_NO_WAIT);
}

// Function to handle disconnection from main.c
void ble_hid_c_on_disconnected(struct bt_conn *conn, uint8_t reason)
{
    LOG_INF("HID client notified of disconnection: %d (0x%02x)", reason, reason);
    
    // Stop discovery timeout timer
    k_timer_stop(&discovery_timeout_timer);
    
    current_state = BLE_HID_STATE_DISCONNECTED;
    if (current_device.conn) {
        bt_conn_unref(current_device.conn);
        current_device.conn = NULL;
    }
}
```

## src/ble_hid_c.h
```c
#ifndef BLE_HID_C_H
#define BLE_HID_C_H

#include <zephyr/kernel.h>
#include <zephyr/bluetooth/bluetooth.h>
#include <zephyr/bluetooth/gatt.h>
#include <zephyr/bluetooth/hci.h>
#include <zephyr/bluetooth/conn.h>
#include <zephyr/bluetooth/uuid.h>
#include <zephyr/bluetooth/gatt.h>

// HID report callback function type
typedef void (*ble_hid_report_callback_t)(const uint8_t *data, uint16_t len);

// HID connection state
typedef enum {
    BLE_HID_STATE_DISCONNECTED,
    BLE_HID_STATE_DISCOVERING,
    BLE_HID_STATE_CONNECTED,
    BLE_HID_STATE_ERROR
} ble_hid_state_t;

// HID device information
typedef struct {
    bt_addr_le_t addr;
    char name[32];
    struct bt_conn *conn;
    uint16_t hid_service_handle;
    uint16_t hid_report_handle;
    uint16_t hid_report_cccd_handle;
    bool notifications_enabled;
} ble_hid_device_t;

// Function declarations
void ble_hid_c_init(ble_hid_report_callback_t callback);
void ble_hid_c_start_scan(void);
void ble_hid_c_stop_scan(void);
void ble_hid_c_disconnect(void);
ble_hid_state_t ble_hid_c_get_state(void);
bool ble_hid_c_is_connected(void);
const ble_hid_device_t* ble_hid_c_get_device(void);

// Event handlers (called from main BLE event handler)
void ble_hid_c_on_ble_evt(struct bt_conn *conn, uint8_t evt_type, struct bt_gatt_attr *attr, void *buf);

// Connection handlers (called from main.c)
void ble_hid_c_on_connected(struct bt_conn *conn);
void ble_hid_c_on_disconnected(struct bt_conn *conn, uint8_t reason);

// Configuration
void ble_hid_c_set_target_name(const char *name);
void ble_hid_c_set_target_address(const bt_addr_le_t *addr);

#endif // BLE_HID_C_H
```

## src/ble_uart_c.c
```c
// BLE UART Central implementation
#include "ble_uart_c.h"
#include <zephyr/logging/log.h>
#include <zephyr/bluetooth/bluetooth.h>
#include <zephyr/bluetooth/gatt.h>
#include <zephyr/bluetooth/hci.h>
#include <zephyr/bluetooth/conn.h>
#include <zephyr/bluetooth/uuid.h>

LOG_MODULE_REGISTER(ble_uart_c, LOG_LEVEL_INF);

// Nordic UART Service UUID
#define BT_UUID_NUS_VAL \
    BT_UUID_128_ENCODE(0x6e400001, 0xb5a3, 0xf393, 0xe0a9, 0xe50e24dcca9e)

// Nordic UART TX Characteristic UUID
#define BT_UUID_NUS_TX_VAL \
    BT_UUID_128_ENCODE(0x6e400003, 0xb5a3, 0xf393, 0xe0a9, 0xe50e24dcca9e)

// Nordic UART RX Characteristic UUID
#define BT_UUID_NUS_RX_VAL \
    BT_UUID_128_ENCODE(0x6e400002, 0xb5a3, 0xf393, 0xe0a9, 0xe50e24dcca9e)

static ble_uart_data_callback_t data_callback = NULL;
static ble_uart_state_t current_state = BLE_UART_STATE_DISCONNECTED;
static ble_uart_device_t current_device = {0};
static char target_name[32] = "";
static bt_addr_le_t target_address = {0};
static bool target_address_set = false;

// More conservative connection parameters for better compatibility
static const struct bt_le_conn_param conservative_conn_param = {
    .interval_min = BT_GAP_INIT_CONN_INT_MIN,  // 30ms
    .interval_max = BT_GAP_INIT_CONN_INT_MAX,  // 50ms
    .latency = 0,
    .timeout = 400,  // 400ms supervision timeout
};

// GATT discovery callbacks
static uint8_t discover_func(struct bt_conn *conn, const struct bt_gatt_attr *attr,
                            struct bt_gatt_discover_params *params)
{
    if (!attr) {
        LOG_INF("NUS service discovery complete");
        return BT_GATT_ITER_STOP;
    }

    const struct bt_gatt_service_val *gatt_service = attr->user_data;
    
    if (bt_uuid_cmp(params->uuid, BT_UUID_DECLARE_16(BT_UUID_NUS_VAL)) == 0) {
        LOG_INF("NUS service found");
        current_device.nus_service_handle = attr->handle;
        
        // Start discovering NUS TX characteristic
        struct bt_gatt_discover_params *discover_params = 
            (struct bt_gatt_discover_params *)params;
        discover_params->uuid = BT_UUID_DECLARE_16(BT_UUID_NUS_TX_VAL);
        discover_params->start_handle = gatt_service->start_handle;
        discover_params->end_handle = gatt_service->end_handle;
        discover_params->type = BT_GATT_DISCOVER_CHARACTERISTIC;
        
        return bt_gatt_discover(conn, discover_params);
    }
    
    if (bt_uuid_cmp(params->uuid, BT_UUID_DECLARE_16(BT_UUID_NUS_TX_VAL)) == 0) {
        const struct bt_gatt_chrc *chrc = attr->user_data;
        LOG_INF("NUS TX characteristic found");
        current_device.nus_tx_handle = chrc->value_handle;
        current_device.nus_tx_cccd_handle = chrc->value_handle + 1;
        
        // Enable notifications for TX
        struct bt_gatt_subscribe_params *subscribe_params = 
            (struct bt_gatt_subscribe_params *)params;
        subscribe_params->value_handle = chrc->value_handle;
        subscribe_params->ccc_handle = chrc->value_handle + 1;
        subscribe_params->value = BT_GATT_CCC_NOTIFY;
        subscribe_params->notify = nus_tx_notify_callback;
        
        return bt_gatt_subscribe(conn, subscribe_params);
    }
    
    return BT_GATT_ITER_STOP;
}

// NUS TX notification callback
static uint8_t nus_tx_notify_callback(struct bt_conn *conn,
                                     struct bt_gatt_subscribe_params *params,
                                     const void *data, uint16_t length)
{
    if (!data) {
        LOG_INF("NUS TX notifications disabled");
        current_device.notifications_enabled = false;
        return BT_GATT_ITER_STOP;
    }
    
    LOG_INF("NUS TX data received: %d bytes", length);
    current_device.notifications_enabled = true;
    
    if (data_callback) {
        data_callback((const uint8_t *)data, length);
    }
    
    return BT_GATT_ITER_CONTINUE;
}

// Connection callback
static void connected(struct bt_conn *conn, uint8_t err)
{
    if (err) {
        LOG_ERR("Connection failed: %d (0x%02x)", err, err);
        
        // Handle specific error codes
        switch (err) {
            case BT_HCI_ERR_CONN_FAIL_TO_ESTAB:
                LOG_ERR("Connection failed to establish - parameters may be unacceptable");
                break;
            case BT_HCI_ERR_CONN_TIMEOUT:
                LOG_ERR("Connection timeout - device may be out of range");
                break;
            case BT_HCI_ERR_UNACCEPT_CONN_PARAM:
                LOG_ERR("Connection parameters unacceptable to peer");
                break;
            default:
                LOG_ERR("Unknown connection error");
                break;
        }
        
        current_state = BLE_UART_STATE_ERROR;
        return;
    }
    
    LOG_INF("Connected to NUS device");
    current_device.conn = bt_conn_ref(conn);
    current_state = BLE_UART_STATE_CONNECTED;
    
    // Start service discovery
    struct bt_gatt_discover_params *discover_params = 
        (struct bt_gatt_discover_params *)k_malloc(sizeof(*discover_params));
    discover_params->uuid = BT_UUID_DECLARE_16(BT_UUID_NUS_VAL);
    discover_params->start_handle = BT_ATT_FIRST_ATTR_HANDLE;
    discover_params->end_handle = BT_ATT_LAST_ATTR_HANDLE;
    discover_params->type = BT_GATT_DISCOVER_PRIMARY;
    discover_params->func = discover_func;
    
    bt_gatt_discover(conn, discover_params);
}

static void disconnected(struct bt_conn *conn, uint8_t reason)
{
    LOG_INF("Disconnected: %d (0x%02x)", reason, reason);
    
    // Handle specific disconnect reasons
    switch (reason) {
        case BT_HCI_ERR_REMOTE_USER_TERM_CONN:
            LOG_INF("Remote device terminated connection");
            break;
        case BT_HCI_ERR_LOCALHOST_TERM_CONN:
            LOG_INF("Local host terminated connection");
            break;
        case BT_HCI_ERR_CONN_TIMEOUT:
            LOG_INF("Connection supervision timeout");
            break;
        default:
            LOG_INF("Other disconnect reason");
            break;
    }
    
    current_state = BLE_UART_STATE_DISCONNECTED;
    if (current_device.conn) {
        bt_conn_unref(current_device.conn);
        current_device.conn = NULL;
    }
}

static struct bt_conn_cb conn_callbacks = {
    .connected = connected,
    .disconnected = disconnected,
};

// Scan callback
static void scan_cb(const bt_addr_le_t *addr, int8_t rssi, uint8_t adv_type,
                   struct net_buf_simple *buf)
{
    char addr_str[BT_ADDR_LE_STR_LEN];
    bt_addr_le_to_str(addr, addr_str, sizeof(addr_str));
    
    LOG_INF("Found device: %s", addr_str);
    
    // Check if this is our target device
    if (target_address_set && bt_addr_le_cmp(addr, &target_address) == 0) {
        LOG_INF("Found target NUS device");
        bt_le_scan_stop();
        
        // Use conservative connection parameters
        int err = bt_conn_le_create(addr, BT_CONN_LE_CREATE_CONN, 
                                   &conservative_conn_param, &current_device.conn);
        if (err) {
            LOG_ERR("Failed to initiate connection: %d", err);
        }
    }
}

void ble_uart_c_init(ble_uart_data_callback_t callback)
{
    data_callback = callback;
    bt_conn_cb_register(&conn_callbacks);
    LOG_INF("BLE UART client initialized");
}

void ble_uart_c_start_scan(void)
{
    current_state = BLE_UART_STATE_DISCOVERING;
    LOG_INF("Starting NUS device scan");
    
    struct bt_le_scan_param scan_param = {
        .type = BT_LE_SCAN_TYPE_PASSIVE,
        .options = BT_LE_SCAN_OPT_NONE,
        .interval = BT_GAP_SCAN_FAST_INTERVAL,
        .window = BT_GAP_SCAN_FAST_WINDOW,
    };
    
    bt_le_scan_start(&scan_param, scan_cb);
}

void ble_uart_c_stop_scan(void)
{
    bt_le_scan_stop();
    LOG_INF("NUS device scan stopped");
}

bool ble_uart_c_connect(const bt_addr_le_t *addr)
{
    if (!addr) {
        return false;
    }
    
    LOG_INF("Connecting to NUS device");
    
    // Use conservative connection parameters
    int err = bt_conn_le_create(addr, BT_CONN_LE_CREATE_CONN, 
                               &conservative_conn_param, &current_device.conn);
    if (err) {
        LOG_ERR("Failed to initiate connection: %d", err);
        return false;
    }
    return true;
}

void ble_uart_c_disconnect(void)
{
    if (current_device.conn) {
        bt_conn_disconnect(current_device.conn, BT_HCI_ERR_REMOTE_USER_TERM_CONN);
    }
}

ble_uart_state_t ble_uart_c_get_state(void)
{
    return current_state;
}

bool ble_uart_c_is_connected(void)
{
    return current_state == BLE_UART_STATE_CONNECTED;
}

const ble_uart_device_t* ble_uart_c_get_device(void)
{
    return &current_device;
}

bool ble_uart_c_send_data(const uint8_t *data, uint16_t len)
{
    if (!current_device.conn || !current_device.nus_rx_handle) {
        return false;
    }
    
    struct bt_gatt_write_params write_params = {
        .func = NULL,
        .handle = current_device.nus_rx_handle,
        .offset = 0,
        .data = data,
        .length = len,
    };
    
    return bt_gatt_write(current_device.conn, &write_params) == 0;
}

void ble_uart_c_on_ble_evt(struct bt_conn *conn, uint8_t evt_type, struct bt_gatt_attr *attr, void *buf)
{
    // Handle BLE events if needed
}

void ble_uart_c_set_target_name(const char *name)
{
    strncpy(target_name, name, sizeof(target_name) - 1);
    target_name[sizeof(target_name) - 1] = '\0';
}

void ble_uart_c_set_target_address(const bt_addr_le_t *addr)
{
    if (addr) {
        bt_addr_le_copy(&target_address, addr);
        target_address_set = true;
    }
}
```

## src/ble_uart_c.h
```c
#ifndef BLE_UART_C_H
#define BLE_UART_C_H

#include <zephyr/kernel.h>
#include <zephyr/bluetooth/bluetooth.h>
#include <zephyr/bluetooth/gatt.h>
#include <zephyr/bluetooth/hci.h>
#include <zephyr/bluetooth/conn.h>
#include <zephyr/bluetooth/uuid.h>
#include <zephyr/bluetooth/gatt.h>

// UART data callback function type
typedef void (*ble_uart_data_callback_t)(const uint8_t *data, uint16_t len);

// UART connection state
typedef enum {
    BLE_UART_STATE_DISCONNECTED,
    BLE_UART_STATE_DISCOVERING,
    BLE_UART_STATE_CONNECTED,
    BLE_UART_STATE_ERROR
} ble_uart_state_t;

// UART device information
typedef struct {
    bt_addr_le_t addr;
    char name[32];
    struct bt_conn *conn;
    uint16_t nus_service_handle;
    uint16_t nus_tx_handle;
    uint16_t nus_tx_cccd_handle;
    uint16_t nus_rx_handle;
    bool notifications_enabled;
} ble_uart_device_t;

// Function declarations
void ble_uart_c_init(ble_uart_data_callback_t callback);
void ble_uart_c_start_scan(void);
void ble_uart_c_stop_scan(void);
bool ble_uart_c_connect(const bt_addr_le_t *addr);
void ble_uart_c_disconnect(void);
ble_uart_state_t ble_uart_c_get_state(void);
bool ble_uart_c_is_connected(void);
const ble_uart_device_t* ble_uart_c_get_device(void);
bool ble_uart_c_send_data(const uint8_t *data, uint16_t len);

// Event handlers (called from main BLE event handler)
void ble_uart_c_on_ble_evt(struct bt_conn *conn, uint8_t evt_type, struct bt_gatt_attr *attr, void *buf);

// Configuration
void ble_uart_c_set_target_name(const char *name);
void ble_uart_c_set_target_address(const bt_addr_le_t *addr);

#endif // BLE_UART_C_H
```

## src/usb.c
```c
/*
 * Copyright (c) 2025 Robert Dale Smith
 * Copyright (c) 2025 Augmental Tech
 *
 * SPDX-License-Identifier: Apache-2.0
 */

/* ============================================================================
 * INCLUDES
 * ============================================================================ */

#include <string.h>
#include <zephyr/kernel.h>
#include <zephyr/device.h>
#include <zephyr/drivers/gpio.h>
#include <zephyr/sys/util.h>
#include <zephyr/usb/usb_device.h>
#include <zephyr/usb/usbd.h>
#include <zephyr/usb/class/usb_hid.h>
#include <zephyr/logging/log.h>

LOG_MODULE_REGISTER(usb_mouse, LOG_LEVEL_INF);

/* ============================================================================
 * GLOBAL VARIABLES
 * ============================================================================ */

/* LED for status indication */
static const struct gpio_dt_spec led0 = GPIO_DT_SPEC_GET(DT_ALIAS(led0), gpios);

/* USB HID device and semaphore - accessible to BLE module for direct sending */
const struct device *hid_dev;
struct k_sem ep_write_sem;

/* USB device status tracking */

/* ============================================================================
 * HID DESCRIPTOR
 * ============================================================================ */

/* USB HID Report Descriptor for MouthPad device
 * 
 * Report Structure:
 * - Report ID 1: Buttons (5 bits) + Padding (3 bits) + Wheel (8 bits) = 16 bits
 * - Report ID 2: X movement (12 bits) + Y movement (12 bits) = 24 bits  
 * - Report ID 3: Consumer controls (volume, media keys, etc.)
 * 
 * This descriptor matches the MouthPad BLE device exactly to eliminate scaling
 */
static const uint8_t hid_report_desc[] = {
    0x05, 0x01,             /* UsagePage (Generic Desktop)           */
    0x09, 0x02,             /* Usage     (Mouse)                     */
    0xA1, 0x01,             /* Collection (Application)              */
      0x85, 0x01,           /*   Report ID (1)                       */
      0x09, 0x01,           /*   Usage     (Pointer)                 */
      0xA1, 0x00,           /*   Collection (Physical)               */

      /* --- 5 button bits + 3 padding bits + 8 wheel bits --------------- */
      0x95, 0x05,           /*   ReportCount 5                       */
      0x75, 0x01,           /*   ReportSize 1                        */
      0x05, 0x09,           /*   UsagePage (Button)                  */
      0x19, 0x01,           /*   Usage Minimum (Button 1)            */
      0x29, 0x05,           /*   Usage Maximum (Button 5)            */
      0x15, 0x00,           /*   Logical Minimum (0)                 */
      0x25, 0x01,           /*   Logical Maximum (1)                 */
      0x81, 0x02,           /*   Input (Data,Var,Abs)                */

      0x95, 0x01,           /*   ReportCount 1                       */
      0x75, 0x03,           /*   ReportSize 3                        */
      0x81, 0x01,           /*   Input (Constant)                    */

      0x75, 0x08,           /*   ReportSize 8                        */
      0x95, 0x01,           /*   ReportCount 1                       */
      0x05, 0x01,           /*   UsagePage (Generic Desktop)         */
      0x09, 0x38,           /*   Usage     (Wheel)                   */
      0x15, 0x81,           /*   Logical Minimum (-127)              */
      0x25, 0x7F,           /*   Logical Maximum (127)               */
      0x81, 0x06,           /*   Input (Data,Var,Rel,NoPref)         */

      0x05, 0x0C,           /*   UsagePage (Consumer)                */
      0x0A, 0x38, 0x02,     /*   Usage     (Volume)                  */
      0x95, 0x01,           /*   ReportCount 1                       */
      0x81, 0x06,           /*   Input (Data,Var,Rel,NoPref)         */

      0xC0,                  /*   End Collection                      */
      0x85, 0x02,           /*   Report ID (2)                       */

      /* --- X and Y movement : 2 × 12-bit signed ------------------------ */
      0x09, 0x01,           /*   Usage     (Pointer)                 */
      0xA1, 0x00,           /*   Collection (Physical)               */
      0x75, 0x0C,           /*   ReportSize 12                       */
      0x95, 0x02,           /*   ReportCount 2                       */
      0x05, 0x01,           /*   UsagePage (Generic Desktop)         */
      0x09, 0x30,           /*   Usage     (X)                       */
      0x09, 0x31,           /*   Usage     (Y)                       */
      0x16, 0x01, 0xF8,     /*   Logical Minimum (-2047)             */
      0x26, 0xFF, 0x07,     /*   Logical Maximum (2047)              */
      0x81, 0x06,           /*   Input (Data,Var,Rel,NoPref)         */

      0xC0,                  /*   End Collection                      */
      0xC0,                  /*   End Collection                      */

      /* --- Consumer controls : Media keys and volume ------------------- */
      0x05, 0x0C,           /*   UsagePage (Consumer)                */
      0x09, 0x01,           /*   Usage     (Consumer Control)        */
      0xA1, 0x01,           /*   Collection (Application)            */
      0x85, 0x03,           /*   Report ID (3)                       */
      0x15, 0x00,           /*   Logical Minimum (0)                 */
      0x25, 0x01,           /*   Logical Maximum (1)                 */
      0x75, 0x01,           /*   ReportSize 1                        */
      0x95, 0x01,           /*   ReportCount 1                       */

      0x09, 0xCD,           /*   Usage     (Play/Pause)              */
      0x81, 0x06,           /*   Input (Data,Var,Rel,NoPref)         */
      0x09, 0xB5,           /*   Usage     (Scan Next Track)         */
      0x81, 0x06,           /*   Input (Data,Var,Rel,NoPref)         */
      0x09, 0xB6,           /*   Usage     (Scan Previous Track)     */
      0x81, 0x06,           /*   Input (Data,Var,Rel,NoPref)         */
      0x09, 0xEA,           /*   Usage     (Volume Up)               */
      0x81, 0x06,           /*   Input (Data,Var,Rel,NoPref)         */
      0x09, 0xE9,           /*   Usage     (Volume Down)             */
      0x81, 0x06,           /*   Input (Data,Var,Rel,NoPref)         */
      0x0A, 0x25, 0x02,     /*   Usage     (Mute)                    */
      0x81, 0x06,           /*   Input (Data,Var,Rel,NoPref)         */
      0x0A, 0x24, 0x02,     /*   Usage     (Power)                   */
      0x81, 0x06,           /*   Input (Data,Var,Rel,NoPref)         */

      0xC0                   /* End Collection                        */
};
static enum usb_dc_status_code usb_status;


/* ============================================================================
 * CONSTANTS AND ENUMERATIONS
 * ============================================================================ */

/* Maximum size for HID reports */
#define MAX_REPORT_SIZE 8

/* Report structure indices for parsing */
enum mouse_report1_idx {
	MOUSE_BTN_REPORT_IDX = 0,    /* Buttons byte */
	MOUSE_WHEEL_REPORT_IDX = 1,  /* Wheel byte */
	MOUSE_REPORT1_COUNT = 2,     /* Total bytes in Report 1 */
};

enum mouse_report2_idx {
	MOUSE_X_LOW_REPORT_IDX = 0,           /* X low 8 bits */
	MOUSE_X_HIGH_Y_LOW_REPORT_IDX = 1,    /* X high 4 bits + Y low 4 bits */
	MOUSE_Y_HIGH_REPORT_IDX = 2,          /* Y high 8 bits */
	MOUSE_REPORT2_COUNT = 3,              /* Total bytes in Report 2 */
};

/* ============================================================================
 * USB CALLBACK FUNCTIONS
 * ============================================================================ */

/**
 * @brief USB device status change callback
 * 
 * @param status New USB device status
 * @param param Additional status parameters (unused)
 */
static inline void status_cb(enum usb_dc_status_code status, const uint8_t *param)
{
	usb_status = status;
}

/**
 * @brief Request USB wakeup if device is suspended
 * 
 * Called when input activity is detected while USB is suspended
 */
static ALWAYS_INLINE void rwup_if_suspended(void)
{
	if (IS_ENABLED(CONFIG_USB_DEVICE_REMOTE_WAKEUP)) {
		if (usb_status == USB_DC_SUSPEND) {
			usb_wakeup_request();
			return;
		}
	}
}

/**
 * @brief USB HID endpoint ready callback
 * 
 * Called when the USB HID interrupt endpoint is ready to accept data.
 * Signals the semaphore to allow BLE module to send reports.
 * 
 * @param dev USB HID device (unused)
 */
static void int_in_ready_cb(const struct device *dev)
{
	ARG_UNUSED(dev);
	k_sem_give(&ep_write_sem);
}

/* USB HID operations structure */
static const struct hid_ops ops = {
	.int_in_ready = int_in_ready_cb,
};

/* ============================================================================
 * PUBLIC FUNCTIONS
 * ============================================================================ */

/**
 * @brief Initialize USB HID device
 * 
 * Sets up the USB HID device with the MouthPad descriptor, configures
 * the LED for status indication, and starts the USB device stack.
 * 
 * The function runs indefinitely, toggling the LED to indicate the
 * system is alive. HID reports are sent directly from BLE callbacks
 * for zero-latency operation.
 * 
 * @return 0 on success, negative error code on failure
 */
int usb_init(void)
{
	int ret;
	
	/* Initialize USB endpoint semaphore */
	k_sem_init(&ep_write_sem, 0, 1);

	/* Configure status LED */
	if (!gpio_is_ready_dt(&led0)) {
		LOG_ERR("LED device %s is not ready", led0.port->name);
		return -ENODEV;
	}

	ret = gpio_pin_configure_dt(&led0, GPIO_OUTPUT);
	if (ret < 0) {
		LOG_ERR("Failed to configure the LED pin, error: %d", ret);
		return ret;
	}

	/* Get USB HID device */
#if defined(CONFIG_USB_DEVICE_STACK_NEXT)
	hid_dev = DEVICE_DT_GET_ONE(zephyr_hid_device);
#else
	hid_dev = device_get_binding("HID_0");
#endif
	if (hid_dev == NULL) {
		LOG_ERR("Cannot get USB HID Device");
		return -ENODEV;
	}

	/* Register HID device with descriptor and callbacks */
	usb_hid_register_device(hid_dev,
				hid_report_desc, sizeof(hid_report_desc),
				&ops);

	usb_hid_init(hid_dev);

	/* Enable USB device stack */
#if defined(CONFIG_USB_DEVICE_STACK_NEXT)
	ret = enable_usb_device_next();
#else
	ret = usb_enable(status_cb);
#endif
	if (ret != 0) {
		LOG_ERR("Failed to enable USB");
		return ret;
	}

	LOG_INF("USB HID device initialized successfully");

	/* Main loop - keep thread alive and indicate system status */
	while (true) {
		k_sleep(K_MSEC(1000));
		/* Toggle LED periodically to show system is alive */
		(void)gpio_pin_toggle(led0.port, led0.pin);
	}
	
	return 0;
}
```

## src/usb.h
```c
/*
 * Copyright (c) 2025 Robert Dale Smith
 * Copyright (c) 2025 Augmental Tech
 *
 * SPDX-License-Identifier: Apache-2.0
 */

#ifndef USB_H
#define USB_H

#include <zephyr/kernel.h>

/**
 * @brief Initialize USB HID device
 *
 * This function initializes the USB HID device as a mouse,
 * sets up the necessary callbacks, and starts the main loop
 * for handling mouse input events.
 *
 * @return 0 on success, negative error code on failure
 */
int usb_init(void);

// Mouse events are now handled through the Zephyr input subsystem
// Use virtual_mouse_send_event() from virtual_mouse.h instead

#endif /* USB_H */
```

## src/usb_cdc.c
```c
// USB CDC (Serial) implementation
#include "usb_cdc.h"
#include "utils.h"
#include "nrf_log.h"
#include "app_error.h"
#include "nrfx_usbd.h"
#include "usb_descriptors.h"
#include <string.h>

static usb_cdc_state_t m_state = USB_CDC_STATE_DISCONNECTED;
static bool m_initialized = false;
static char m_device_name[64] = "BLE-USB Bridge CDC";
static char m_manufacturer_name[64] = "Nordic";
static char m_product_name[64] = "BLE-USB Bridge CDC";
static usb_cdc_rx_callback_t m_rx_callback = NULL;

// USB CDC Data Buffer
static uint8_t m_cdc_tx_buffer[64];
static uint8_t m_cdc_rx_buffer[64];
static uint16_t m_cdc_tx_len = 0;

void usb_cdc_init(void)
{
    if (m_initialized) {
        return;
    }
    
    // Initialize USB device (shared with HID)
    // Note: In a real implementation, this would be coordinated with USB HID
    // For now, we assume USB is already initialized by HID module
    
    m_initialized = true;
    m_state = USB_CDC_STATE_DISCONNECTED;
    
    NRF_LOG_INFO("USB CDC initialized");
}

void usb_cdc_start(void)
{
    if (!m_initialized) {
        NRF_LOG_ERROR("USB CDC not initialized");
        return;
    }
    
    // USB is started by HID module
    NRF_LOG_INFO("USB CDC started");
}

void usb_cdc_stop(void)
{
    if (!m_initialized) {
        return;
    }
    
    m_state = USB_CDC_STATE_DISCONNECTED;
    
    NRF_LOG_INFO("USB CDC stopped");
}

usb_cdc_state_t usb_cdc_get_state(void)
{
    return m_state;
}

bool usb_cdc_is_connected(void)
{
    return m_state == USB_CDC_STATE_CONNECTED;
}

bool usb_cdc_send_data(const uint8_t *data, uint16_t len)
{
    if (!usb_cdc_is_connected()) {
        NRF_LOG_WARNING("Cannot send CDC data: USB not connected");
        return false;
    }
    
    if (len > sizeof(m_cdc_tx_buffer)) {
        NRF_LOG_ERROR("CDC data too large: %d > %d", len, sizeof(m_cdc_tx_buffer));
        return false;
    }
    
    // Copy data to buffer
    memcpy(m_cdc_tx_buffer, data, len);
    m_cdc_tx_len = len;
    
    // Send data via USB CDC endpoint
    ret_code_t err_code = nrfx_usbd_ep_easy_dma_transfer(NRFX_USBD_EPIN2, 
                                                        m_cdc_tx_buffer, 
                                                        m_cdc_tx_len);
    if (err_code != NRF_SUCCESS) {
        NRF_LOG_ERROR("Failed to send CDC data: %d", err_code);
        return false;
    }
    
    NRF_LOG_INFO("CDC data sent, length: %d", len);
    utils_hex_dump(data, len);
    
    return true;
}

bool usb_cdc_send_string(const char *str)
{
    uint16_t len = strlen(str);
    return usb_cdc_send_data((const uint8_t*)str, len);
}

bool usb_cdc_send_line(const char *str)
{
    char line_buffer[128];
    snprintf(line_buffer, sizeof(line_buffer), "%s\r\n", str);
    return usb_cdc_send_string(line_buffer);
}

void usb_cdc_set_device_name(const char *name)
{
    strncpy(m_device_name, name, sizeof(m_device_name) - 1);
    m_device_name[sizeof(m_device_name) - 1] = '\0';
}

void usb_cdc_set_manufacturer_name(const char *name)
{
    strncpy(m_manufacturer_name, name, sizeof(m_manufacturer_name) - 1);
    m_manufacturer_name[sizeof(m_manufacturer_name) - 1] = '\0';
}

void usb_cdc_set_product_name(const char *name)
{
    strncpy(m_product_name, name, sizeof(m_product_name) - 1);
    m_product_name[sizeof(m_product_name) - 1] = '\0';
}

void usb_cdc_set_rx_callback(usb_cdc_rx_callback_t callback)
{
    m_rx_callback = callback;
}

void usb_cdc_on_usbd_evt(nrfx_usbd_evt_t const * p_event)
{
    switch (p_event->type) {
        case NRFX_USBD_EVT_READY:
            {
                NRF_LOG_INFO("USB CDC device ready");
                m_state = USB_CDC_STATE_CONNECTED;
            }
            break;
            
        case NRFX_USBD_EVT_DETECTED:
            {
                NRF_LOG_INFO("USB CDC host detected");
            }
            break;
            
        case NRFX_USBD_EVT_REMOVED:
            {
                NRF_LOG_INFO("USB CDC host removed");
                m_state = USB_CDC_STATE_DISCONNECTED;
            }
            break;
            
        case NRFX_USBD_EVT_SUSPEND:
            {
                NRF_LOG_INFO("USB CDC suspended");
                m_state = USB_CDC_STATE_SUSPENDED;
            }
            break;
            
        case NRFX_USBD_EVT_RESUME:
            {
                NRF_LOG_INFO("USB CDC resumed");
                m_state = USB_CDC_STATE_CONNECTED;
            }
            break;
            
        case NRFX_USBD_EVT_WUREQ:
            {
                NRF_LOG_INFO("USB CDC wake-up request");
            }
            break;
            
        case NRFX_USBD_EVT_SETUP:
            {
                // Handle USB setup requests for CDC
                const nrfx_usbd_setup_t *p_setup = &p_event->data.setup;
                
                switch (p_setup->bmRequestType) {
                    case 0x21:  // Host to Device, Class, Interface
                        {
                            switch (p_setup->bRequest) {
                                case 0x20:  // SET_LINE_CODING
                                    {
                                        // Handle line coding setup
                                        NRF_LOG_INFO("SET_LINE_CODING request");
                                    }
                                    break;
                                    
                                case 0x22:  // SET_CONTROL_LINE_STATE
                                    {
                                        // Handle control line state
                                        NRF_LOG_INFO("SET_CONTROL_LINE_STATE request");
                                    }
                                    break;
                                    
                                default:
                                    break;
                            }
                        }
                        break;
                        
                    case 0xA1:  // Device to Host, Class, Interface
                        {
                            switch (p_setup->bRequest) {
                                case 0x21:  // GET_LINE_CODING
                                    {
                                        // Send line coding
                                        uint8_t line_coding[7] = {
                                            0x80, 0x25, 0x00, 0x00,  // 9600 baud
                                            0x00, 0x00, 0x00         // 1 stop bit, no parity, 8 data bits
                                        };
                                        nrfx_usbd_ep_easy_dma_transfer(NRFX_USBD_EPIN0, 
                                                                      line_coding, 
                                                                      sizeof(line_coding));
                                    }
                                    break;
                                    
                                default:
                                    break;
                            }
                        }
                        break;
                        
                    default:
                        break;
                }
            }
            break;
            
        case NRFX_USBD_EVT_EPTRANSFER:
            {
                // Handle endpoint transfer completion
                const nrfx_usbd_ep_transfer_t *p_transfer = &p_event->data.eptransfer;
                
                if (p_transfer->ep == NRFX_USBD_EPIN2) {
                    NRF_LOG_INFO("CDC data transfer completed");
                } else if (p_transfer->ep == NRFX_USBD_EPOUT2) {
                    // Data received from host
                    NRF_LOG_INFO("CDC data received, length: %d", p_transfer->size);
                    utils_hex_dump(p_transfer->p_data, p_transfer->size);
                    
                    // Forward to callback
                    if (m_rx_callback != NULL) {
                        m_rx_callback(p_transfer->p_data, p_transfer->size);
                    }
                    
                    // Prepare for next reception
                    nrfx_usbd_ep_easy_dma_transfer(NRFX_USBD_EPOUT2, 
                                                  m_cdc_rx_buffer, 
                                                  sizeof(m_cdc_rx_buffer));
                }
            }
            break;
            
        default:
            break;
    }
}
```

## src/usb_cdc.h
```c
#ifndef USB_CDC_H
#define USB_CDC_H

#include <stdint.h>
#include <stdbool.h>
#include "nrfx_usbd.h"

// USB CDC device states
typedef enum {
    USB_CDC_STATE_DISCONNECTED,
    USB_CDC_STATE_CONNECTED,
    USB_CDC_STATE_SUSPENDED,
    USB_CDC_STATE_ERROR
} usb_cdc_state_t;

// Function declarations
void usb_cdc_init(void);
void usb_cdc_start(void);
void usb_cdc_stop(void);
usb_cdc_state_t usb_cdc_get_state(void);
bool usb_cdc_is_connected(void);
bool usb_cdc_send_data(const uint8_t *data, uint16_t len);
bool usb_cdc_send_string(const char *str);
bool usb_cdc_send_line(const char *str);

// USB event handlers
void usb_cdc_on_usbd_evt(nrfx_usbd_evt_t const * p_event);

// Configuration
void usb_cdc_set_device_name(const char *name);
void usb_cdc_set_manufacturer_name(const char *name);
void usb_cdc_set_product_name(const char *name);

// Data reception callback
typedef void (*usb_cdc_rx_callback_t)(const uint8_t *data, uint16_t len);
void usb_cdc_set_rx_callback(usb_cdc_rx_callback_t callback);

#endif // USB_CDC_H
```
