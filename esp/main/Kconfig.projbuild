## esp/main/Kconfig.projbuild
```kconfig
menu "MouthPad Configuration"

    choice MOUTHPAD_BOARD_TYPE
        prompt "Board Type"
        default MOUTHPAD_BOARD_XIAO_ESP32S3
        help
            Select the target board for MouthPad^USB.

        config MOUTHPAD_BOARD_XIAO_ESP32S3
            bool "XIAO ESP32-S3"
            help
                Seeed Studio XIAO ESP32-S3 development board.
                Features built-in LED on GPIO 21.

        config MOUTHPAD_BOARD_LILYGO_T_DISPLAY_S3
            bool "LilyGo T-Display-S3"
            help
                LilyGo T-Display-S3 development board with 1.9" LCD.
                No built-in user LED, display pins reserved for future use.

    endchoice

    config MOUTHPAD_BOARD_NAME
        string
        default "seeed_xiao_esp32s3" if MOUTHPAD_BOARD_XIAO_ESP32S3
        default "lilygo_tdisplay_s3" if MOUTHPAD_BOARD_LILYGO_T_DISPLAY_S3

    config MOUTHPAD_LED_GPIO
        int
        default 21 if MOUTHPAD_BOARD_XIAO_ESP32S3
        default -1 if MOUTHPAD_BOARD_LILYGO_T_DISPLAY_S3
        help
            GPIO pin for status LED. Set to -1 to disable LED functionality.

    config MOUTHPAD_LED_ACTIVE_LOW
        bool
        default y if MOUTHPAD_BOARD_XIAO_ESP32S3
        default n if MOUTHPAD_BOARD_LILYGO_T_DISPLAY_S3
        help
            Set to Y if the LED turns on when the GPIO is driven low.

    config MOUTHPAD_BUTTON_GPIO
        int
        default 0
        help
            GPIO pin for user button (boot button on most boards).

endmenu
```

## esp32/sdkconfig.defaults
```kconfig
CONFIG_BT_ENABLED=y
CONFIG_BTDM_CTRL_MODE_BTDM=y
CONFIG_BT_BLUEDROID_ENABLED=y
CONFIG_BT_CLASSIC_ENABLED=y
CONFIG_BT_BLE_ENABLED=y
CONFIG_BT_HID_ENABLED=y
CONFIG_BT_HID_HOST_ENABLED=y
CONFIG_BT_BLE_42_FEATURES_SUPPORTED=y
CONFIG_BT_GATTC_NOTIF_REG_MAX=16
CONFIG_PARTITION_TABLE_SINGLE_APP_LARGE=y
CONFIG_ESP_MAIN_TASK_STACK_SIZE=7168
CONFIG_ESP_TASK_WDT_INIT=n

CONFIG_TINYUSB_HID_COUNT=1

CONFIG_TINYUSB_CDC_ENABLED=y
CONFIG_TINYUSB_CDC_COUNT=1
CONFIG_TINYUSB_CDC_RX_BUFSIZE=256
CONFIG_TINYUSB_CDC_TX_BUFSIZE=256
```

## ncs/app/boards/nrf52840dongle_nrf52840.conf
```kconfig
# Board-specific configuration for nRF52840 Dongle with Adafruit UF2 Bootloader
# SoftDevice S140 6.1.1 layout
#
# NOTE: Partition layout is defined in pm_static_nrf52840dongle_nrf52840.yml
# NOTE: BOARD_HAS_NRF5_BOOTLOADER=n is set in nrf52840dongle_nrf52840_defconfig

# Build UF2 for Adafruit bootloader
CONFIG_BUILD_OUTPUT_UF2=y

# Disable MCUboot (we're using UF2 bootloader instead)
CONFIG_BOOTLOADER_MCUBOOT=n

# Disable Nordic bootloader support (set in defconfig, reinforced here)
CONFIG_BOARD_HAS_NRF5_BOOTLOADER=n

# Disable BT settings temporarily for testing
CONFIG_BT_SETTINGS=y

# NVS configuration for storage partition (32KB at 0xec000 from pm_static)
CONFIG_SETTINGS_NVS_SECTOR_COUNT=8
CONFIG_SETTINGS_NVS_SECTOR_SIZE_MULT=1

# Hardware stack protection
CONFIG_HW_STACK_PROTECTION=y

# Disable display support
CONFIG_DISPLAY=n

# Flash and partition support
CONFIG_FLASH=y
CONFIG_FLASH_PAGE_LAYOUT=y
CONFIG_FLASH_MAP=y
CONFIG_USE_DT_CODE_PARTITION=y
```

## ncs/app/boards/nrf52840dongle_nrf52840.raytac.conf
```kconfig
# Board-specific configuration for Raytac MDBT50Q-RX
# Based on nRF52840 Dongle with Adafruit UF2 Bootloader
# No SoftDevice variant (code starts at 0x1000)

# Dongle variant identifier
CONFIG_DONGLE_VARIANT_STRING="raytac"

# Build UF2 for Adafruit bootloader
CONFIG_BUILD_OUTPUT_UF2=y

# Disable MCUboot (we're using UF2 bootloader instead)
CONFIG_BOOTLOADER_MCUBOOT=n

# Disable Nordic bootloader support (set in defconfig, reinforced here)
CONFIG_BOARD_HAS_NRF5_BOOTLOADER=n

# Enable BT settings with NVS backend for persistent storage
CONFIG_BT_SETTINGS=y

# NVS backend for settings (required for persistence to flash)
CONFIG_SETTINGS_NVS=y

# NVS configuration for storage partition (64KB at 0xee000 from pm_static)
CONFIG_SETTINGS_NVS_SECTOR_COUNT=8
CONFIG_SETTINGS_NVS_SECTOR_SIZE_MULT=1

# Hardware stack protection
CONFIG_HW_STACK_PROTECTION=y

# Disable display support
CONFIG_DISPLAY=n

# Flash and partition support
CONFIG_FLASH=y
CONFIG_FLASH_PAGE_LAYOUT=y
CONFIG_FLASH_MAP=y
CONFIG_USE_DT_CODE_PARTITION=y
```

## ncs/app/boards/raytac_mdbt50q_cx_40.conf
```kconfig
# Raytac MDBT50Q-CX-40 Dongle configuration for MouthPad^USB
# This file only contains board-specific overrides
# Main configuration is in prj.conf

# Nordic nRF5 bootloader support (required for this board)
CONFIG_BOARD_HAS_NRF5_BOOTLOADER=y

# DFU bootloader requires HEX, not UF2
CONFIG_BUILD_OUTPUT_UF2=n
CONFIG_BUILD_OUTPUT_HEX=y

# DON'T use DT code partition - use 0x1000 like the BLE sniffer firmware
# CONFIG_USE_DT_CODE_PARTITION=y

# Disable features not present on this board
CONFIG_SSD1306=n
CONFIG_DISPLAY=n

# Use NCS Partition Manager for Settings storage with Nordic DFU bootloader
# This is the proper NCS way (not manual DTS partitions)
# Partition layout defined in pm_static_raytac_mdbt50q_cx_40_dongle.yml
CONFIG_PARTITION_MANAGER_ENABLED=y

# Don't let partition manager try to update runners (causes CI build failure)
# The CX-40 uses Nordic DFU bootloader, not west flash
CONFIG_PM_OVERRIDE_EXTERNAL_DRIVER_CHECK=y

# Re-enable Settings/NVS now that we're using Partition Manager
# CONFIG_SETTINGS=n
# CONFIG_NVS=n
# CONFIG_FCB=n
# CONFIG_BT_SETTINGS=n
```

## ncs/app/boards/seeed_xiao_nrf52840.conf
```kconfig
# XIAO nRF52840 specific configuration
# Uses MCUboot, needs custom partition support

# Board variant identifier
CONFIG_DONGLE_VARIANT_STRING="seeed_xiao_nrf52840"

CONFIG_FLASH=y
CONFIG_FLASH_PAGE_LAYOUT=y
CONFIG_FLASH_MAP=y
CONFIG_USE_DT_CODE_PARTITION=y

# Enable BT settings with NVS backend for persistent storage
CONFIG_BT_SETTINGS=y

# NVS backend for settings (required for persistence to flash)
CONFIG_SETTINGS_NVS=y

# NVS configuration for storage partition
CONFIG_SETTINGS_NVS_SECTOR_COUNT=8
CONFIG_SETTINGS_NVS_SECTOR_SIZE_MULT=1
```

## ncs/app/tests/unit/ble_bas/testcase.yaml
```yaml
tests:
  app.unit.ble_bas.color_discrete:
    type: unit
    tags: ble battery discrete
  app.unit.ble_bas.color_gradient:
    type: unit
    tags: ble battery gradient
```

## ncs/samples/dual_cdc_hid/Kconfig
```kconfig
# Copyright (c) 2023 Nordic Semiconductor ASA
# SPDX-License-Identifier: Apache-2.0

# Source common USB sample options used to initialize new experimental USB
# device stack. Use our local copy with custom VID.
rsource "Kconfig.sample_usbd"

source "Kconfig.zephyr"
```

## ncs/samples/dual_cdc_hid/boards/nrf52840dongle.conf
```kconfig
# April Brothers nRF52840 Dongle specific configuration
# Uses UF2 bootloader WITHOUT SoftDevice, needs custom partition support
CONFIG_FLASH=y
CONFIG_FLASH_PAGE_LAYOUT=y
CONFIG_FLASH_MAP=y
CONFIG_USE_DT_CODE_PARTITION=y
```

## ncs/samples/dual_cdc_hid/boards/xiao_ble.conf
```kconfig
# XIAO nRF52840 specific configuration
# Uses MCUboot, needs custom partition support
CONFIG_FLASH=y
CONFIG_FLASH_PAGE_LAYOUT=y
CONFIG_FLASH_MAP=y
CONFIG_USE_DT_CODE_PARTITION=y
```
