## CMakeLists.txt
```
#
# Copyright (c) 2018 Nordic Semiconductor
#
# SPDX-License-Identifier: LicenseRef-Nordic-5-Clause
#
cmake_minimum_required(VERSION 3.20.0)

find_package(Zephyr REQUIRED HINTS $ENV{ZEPHYR_BASE})
project(central_uart)

# NORDIC SDK APP START
  target_sources(app PRIVATE
    src/main.c
    src/usb_cdc.c
    src/ble_central.c
    src/ble_nus_client.c
    src/ble_transport.c
  )
# NORDIC SDK APP END
```

## prj.conf
```kconfig
#
# Copyright (c) 2018 Nordic Semiconductor
#
# SPDX-License-Identifier: LicenseRef-Nordic-5-Clause
#

# Enable the UART driver
CONFIG_UART_ASYNC_API=y
CONFIG_NRFX_UARTE0=y
CONFIG_SERIAL=y
CONFIG_CONSOLE=y
CONFIG_UART_CONSOLE=n

# Enable RTT for console output
CONFIG_USE_SEGGER_RTT=y
CONFIG_RTT_CONSOLE=y

# Enable USB CDC ACM for screen communication
CONFIG_USB_DEVICE_STACK=y
CONFIG_USB_CDC_ACM=y
CONFIG_USB_CDC_ACM_RINGBUF_SIZE=1024
CONFIG_USB_DEVICE_INITIALIZE_AT_BOOT=y
CONFIG_USB_DEVICE_PRODUCT="MouthPad^USB"
CONFIG_USB_DEVICE_MANUFACTURER="Augmental.Tech"
CONFIG_USB_DEVICE_SN="12345678901234567890"
CONFIG_USB_DEVICE_PID=0xEEEE
CONFIG_USB_DEVICE_VID=0x1915

# Enable the BLE stack with GATT Client configuration
CONFIG_BT=y
CONFIG_BT_CENTRAL=y
CONFIG_BT_SMP=y
CONFIG_BT_GATT_CLIENT=y

# Enable the BLE modules from NCS
CONFIG_BT_NUS_CLIENT=y
CONFIG_BT_SCAN=y
CONFIG_BT_SCAN_FILTER_ENABLE=y
CONFIG_BT_SCAN_UUID_CNT=1
CONFIG_BT_SCAN_ADDRESS_CNT=1
CONFIG_BT_GATT_DM=y
CONFIG_HEAP_MEM_POOL_SIZE=2048

# This example requires more stack
CONFIG_SYSTEM_WORKQUEUE_STACK_SIZE=2048
# Enable bonding
CONFIG_BT_SETTINGS=y
CONFIG_FLASH=y
CONFIG_FLASH_PAGE_LAYOUT=y
CONFIG_FLASH_MAP=y

# Config logger
CONFIG_LOG=y
CONFIG_LOG_BACKEND_RTT=y
CONFIG_LOG_BACKEND_UART=n

CONFIG_ASSERT=y
```

## app.overlay
```dts
/*
 * Copyright (c) 2023 Nordic Semiconductor ASA
 *
 * SPDX-License-Identifier: LicenseRef-Nordic-5-Clause
 */

/ {
	chosen {
		nordic,nus-uart = &board_cdc_acm_uart;
	};
};

&zephyr_udc0 {
	board_cdc_acm_uart: board_cdc_acm_uart {
		compatible = "zephyr,cdc-acm-uart";
	};
};
```

## src/main.c
```c
/*
 * Copyright (c) 2025 Robert Dale Smith
 * Copyright (c) 2025 Augmental Tech
 *
 * SPDX-License-Identifier: Apache-2.0
 */

/** @file
 *  @brief MouthPad USB Bridge - Main Application
 */

#include <zephyr/sys/printk.h>
#include <zephyr/logging/log.h>

#include "usb_cdc.h"
#include "ble_transport.h"

#define LOG_MODULE_NAME central_uart
LOG_MODULE_REGISTER(LOG_MODULE_NAME);



int main(void)
{
	int err;

	LOG_INF("=== MouthPad USB Bridge Starting ===");

	/* Initialize USB CDC */
	LOG_INF("Initializing USB CDC...");
	err = usb_cdc_init();
	if (err != 0) {
		LOG_ERR("usb_cdc_init failed (err %d)", err);
		return 0;
	}
	LOG_INF("USB CDC initialized successfully");

	/* Initialize BLE Transport */
	LOG_INF("Initializing BLE Transport...");
	err = ble_transport_init();
	if (err != 0) {
		LOG_ERR("ble_transport_init failed (err %d)", err);
		return 0;
	}
	LOG_INF("BLE Transport initialized successfully");

	/* Start bridging */
	ble_transport_start_bridging();

	LOG_INF("Starting USB ↔ BLE bridge");

	for (;;) {
		/* USB CDC ↔ BLE NUS Bridge */
		
		// Check for data from USB CDC and send to NUS
		static uint8_t cdc_buffer[UART_BUF_SIZE];
		static int cdc_pos = 0;
		
		uint8_t c;
		int bytes_read = usb_cdc_receive_data(&c, 1);
		
		if (bytes_read > 0) { // Data received from CDC
			cdc_buffer[cdc_pos] = c;
			cdc_pos++;
			
			// Send complete command when we get newline
			if (c == '\n' || c == '\r' || cdc_pos >= UART_BUF_SIZE) {
				if (cdc_pos > 1) { // Don't send empty commands
					if (ble_transport_is_nus_ready()) {
						LOG_INF("Sending command (%d bytes): %.*s", cdc_pos, cdc_pos, cdc_buffer);
						err = ble_transport_send_nus_data(cdc_buffer, cdc_pos);
						if (err) {
							LOG_ERR("CDC→NUS FAILED (err %d)", err);
						} else {
							LOG_INF("Command sent successfully");
						}
					} else {
						LOG_DBG("NUS client not ready - waiting for service discovery");
					}
				}
				cdc_pos = 0; // Reset buffer
			}
		}
		
		// Small delay to prevent busy waiting
		k_sleep(K_MSEC(1));
	}
}
```

## src/ble_transport.h
```c
/*
 * Copyright (c) 2025 Robert Dale Smith
 * Copyright (c) 2025 Augmental Tech
 *
 * SPDX-License-Identifier: Apache-2.0
 */

#ifndef BLE_TRANSPORT_H
#define BLE_TRANSPORT_H

#include <zephyr/kernel.h>
#include <zephyr/bluetooth/conn.h>

/* Callback function types */
typedef void (*ble_data_callback_t)(const uint8_t *data, uint16_t len);
typedef void (*ble_ready_callback_t)(void);

/* BLE Transport initialization and control functions */
int ble_transport_init(void);
int ble_transport_start_bridging(void);

/* USB CDC callback type */
typedef void (*usb_cdc_send_cb_t)(const uint8_t *data, uint16_t len);

/* Transport registration functions */
int ble_transport_register_usb_cdc_callback(usb_cdc_send_cb_t cb);

/* NUS Transport functions */
int ble_transport_send_nus_data(const uint8_t *data, uint16_t len);
bool ble_transport_is_nus_ready(void);

/* Future HID Transport functions (for later integration) */
int ble_transport_register_hid_data_callback(ble_data_callback_t cb);
int ble_transport_register_hid_ready_callback(ble_ready_callback_t cb);
int ble_transport_send_hid_data(const uint8_t *data, uint16_t len);
bool ble_transport_is_hid_ready(void);

/* Internal transport state management */
void ble_transport_handle_connection(struct bt_conn *conn);
void ble_transport_handle_disconnection(struct bt_conn *conn, uint8_t reason);

#endif /* BLE_TRANSPORT_H */ 
```

## src/usb_cdc.c
```c
/*
 * Copyright (c) 2025 Robert Dale Smith
 * Copyright (c) 2025 Augmental Tech
 *
 * SPDX-License-Identifier: Apache-2.0
 */

#include "usb_cdc.h"
#include <zephyr/kernel.h>
#include <zephyr/device.h>
#include <zephyr/devicetree.h>
#include <zephyr/sys/printk.h>
#include <zephyr/logging/log.h>

LOG_MODULE_REGISTER(usb_cdc, LOG_LEVEL_INF);

/* UART device for USB CDC */
static const struct device *uart = DEVICE_DT_GET(DT_CHOSEN(nordic_nus_uart));

/* Work structures for UART handling */
static struct k_work_delayable uart_work;

/* FIFOs for UART data */
static K_FIFO_DEFINE(fifo_uart_tx_data);
static K_FIFO_DEFINE(fifo_uart_rx_data);

/* Calculate CRC-16 (CCITT) for data integrity checking */
uint16_t calculate_crc16(const uint8_t *data, uint16_t len)
{
	uint16_t crc = 0xFFFF; // Initial value
	
	for (uint16_t i = 0; i < len; i++) {
		crc ^= (uint16_t)data[i] << 8;
		for (int j = 0; j < 8; j++) {
			if (crc & 0x8000) {
				crc = (crc << 1) ^ 0x1021; // CCITT polynomial
			} else {
				crc = crc << 1;
			}
		}
	}
	
	return crc & 0xFFFF;
}

/* UART callback for handling UART events */
static void uart_cb(const struct device *dev, struct uart_event *evt, void *user_data)
{
	ARG_UNUSED(dev);

	static size_t aborted_len;
	struct uart_data_t *buf;
	static uint8_t *aborted_buf;
	static bool disable_req;

	switch (evt->type) {
	case UART_TX_DONE:
		LOG_DBG("UART_TX_DONE");
		if ((evt->data.tx.len == 0) ||
		    (!evt->data.tx.buf)) {
			return;
		}

		if (aborted_buf) {
			buf = CONTAINER_OF(aborted_buf, struct uart_data_t,
					   data[0]);
			aborted_buf = NULL;
			aborted_len = 0;
		} else {
			buf = CONTAINER_OF(evt->data.tx.buf,
					   struct uart_data_t,
					   data[0]);
		}

		k_free(buf);

		buf = k_fifo_get(&fifo_uart_tx_data, K_NO_WAIT);
		if (!buf) {
			return;
		}

		if (uart_tx(uart, buf->data, buf->len, SYS_FOREVER_MS)) {
			LOG_WRN("Failed to send data over UART");
		}

		break;

	case UART_RX_RDY:
		LOG_DBG("UART_RX_RDY");
		buf = CONTAINER_OF(evt->data.rx.buf, struct uart_data_t, data[0]);
		buf->len += evt->data.rx.len;

		// Debug: Print received UART data
		printk("*** UART RX: Received %d bytes ***\n", evt->data.rx.len);
		for (int i = 0; i < evt->data.rx.len; i++) {
			printk("%c", evt->data.rx.buf[i]);
		}
		printk("***\n");

		if (disable_req) {
			return;
		}

		if ((evt->data.rx.buf[buf->len - 1] == '\n') ||
		    (evt->data.rx.buf[buf->len - 1] == '\r')) {
			disable_req = true;
			uart_rx_disable(uart);
		}

		break;

	case UART_RX_DISABLED:
		LOG_DBG("UART_RX_DISABLED");
		disable_req = false;

		buf = k_malloc(sizeof(*buf));
		if (buf) {
			buf->len = 0;
		} else {
			LOG_WRN("Not able to allocate UART receive buffer");
			k_work_reschedule(&uart_work, UART_WAIT_FOR_BUF_DELAY);
			return;
		}

		uart_rx_enable(uart, buf->data, sizeof(buf->data),
			       UART_RX_TIMEOUT);

		break;

	case UART_RX_BUF_REQUEST:
		LOG_DBG("UART_RX_BUF_REQUEST");
		buf = k_malloc(sizeof(*buf));
		if (buf) {
			buf->len = 0;
			uart_rx_buf_rsp(uart, buf->data, sizeof(buf->data));
		} else {
			LOG_WRN("Not able to allocate UART receive buffer");
		}

		break;

	case UART_RX_BUF_RELEASED:
		LOG_DBG("UART_RX_BUF_RELEASED");
		buf = CONTAINER_OF(evt->data.rx_buf.buf, struct uart_data_t,
				   data[0]);

		if (buf->len > 0) {
			k_fifo_put(&fifo_uart_rx_data, buf);
		} else {
			k_free(buf);
		}

		break;

	case UART_TX_ABORTED:
		LOG_DBG("UART_TX_ABORTED");
		if (!aborted_buf) {
			aborted_buf = (uint8_t *)evt->data.tx.buf;
		}

		aborted_len += evt->data.tx.len;
		buf = CONTAINER_OF(aborted_buf, struct uart_data_t,
				   data[0]);

		uart_tx(uart, &buf->data[aborted_len],
			buf->len - aborted_len, SYS_FOREVER_MS);

		break;

	default:
		break;
	}
}

/* UART work handler for delayed operations */
static void uart_work_handler(struct k_work *item)
{
	struct uart_data_t *buf;

	buf = k_malloc(sizeof(*buf));
	if (buf) {
		buf->len = 0;
	} else {
		LOG_WRN("Not able to allocate UART receive buffer");
		k_work_reschedule(&uart_work, UART_WAIT_FOR_BUF_DELAY);
		return;
	}

	uart_rx_enable(uart, buf->data, sizeof(buf->data), UART_RX_TIMEOUT);
}

/* Initialize USB CDC (UART) functionality */
int usb_cdc_init(void)
{
	struct uart_data_t *rx;

	printk("usb_cdc_init: Starting UART initialization\n");
	printk("usb_cdc_init: Using UART device: %s\n", uart->name);

	if (!device_is_ready(uart)) {
		printk("usb_cdc_init: UART device not ready\n");
		LOG_ERR("UART device not ready");
		return -ENODEV;
	}
	printk("usb_cdc_init: UART device is ready\n");

	rx = k_malloc(sizeof(*rx));
	if (rx) {
		rx->len = 0;
		printk("usb_cdc_init: Allocated RX buffer\n");
	} else {
		printk("usb_cdc_init: Failed to allocate RX buffer\n");
		return -ENOMEM;
	}

	printk("usb_cdc_init: Initializing UART work handler\n");
	k_work_init_delayable(&uart_work, uart_work_handler);

	printk("usb_cdc_init: Skipping UART callback setup - using polling instead\n");
	printk("usb_cdc_init: UART initialization successful\n");
	return 0;
}

/* Send data to USB CDC with robust packet framing */
int usb_cdc_send_data(const uint8_t *data, uint16_t len)
{
	if (!data || len == 0) {
		return -EINVAL;
	}

	printk("*** FORWARDING %d BYTES TO CDC WITH NEW FRAMING ***\n", len);
	
	// Calculate CRC-16 for the payload
	uint16_t crc = calculate_crc16(data, len);
	
	// Send dual start markers
	uart_poll_out(uart, 0xAA); // First start marker
	uart_poll_out(uart, 0x55); // Second start marker
	
	// Send packet length (2 bytes, big-endian)
	uart_poll_out(uart, (len >> 8) & 0xFF); // High byte
	uart_poll_out(uart, len & 0xFF);        // Low byte
	
	// Send packet data
	for (uint16_t i = 0; i < len; i++) {
		uart_poll_out(uart, data[i]);
	}
	
	// Send CRC (2 bytes, big-endian)
	uart_poll_out(uart, (crc >> 8) & 0xFF); // CRC high byte
	uart_poll_out(uart, crc & 0xFF);        // CRC low byte
	
	return 0;
}

/* Receive data from USB CDC */
int usb_cdc_receive_data(uint8_t *buffer, uint16_t max_len)
{
	if (!buffer || max_len == 0) {
		return -EINVAL;
	}

	// Simple polling-based receive for now
	unsigned char c;
	int bytes_read = uart_poll_in(uart, &c);
	
	if (bytes_read == 0) { // Data received from CDC
		*buffer = c;
		return 1; // Return 1 byte received
	}
	
	return 0; // No data available
}

/* Get UART device for external use */
const struct device *usb_cdc_get_uart_device(void)
{
	return uart;
} 
```

## src/usb_cdc.h
```c
/*
 * Copyright (c) 2025 Robert Dale Smith
 * Copyright (c) 2025 Augmental Tech
 *
 * SPDX-License-Identifier: Apache-2.0
 */

#ifndef USB_CDC_H
#define USB_CDC_H

#include <zephyr/kernel.h>
#include <zephyr/device.h>
#include <zephyr/drivers/uart.h>

/* UART payload buffer element size. */
#define UART_BUF_SIZE 128

/* UART timing constants */
#define UART_WAIT_FOR_BUF_DELAY K_MSEC(50)
#define UART_RX_TIMEOUT 50000 /* Wait for RX complete event time in microseconds. */

/* USB CDC data structure */
struct uart_data_t {
	void *fifo_reserved;
	uint8_t  data[UART_BUF_SIZE];
	uint16_t len;
};

/* USB CDC initialization and control functions */
int usb_cdc_init(void);
int usb_cdc_send_data(const uint8_t *data, uint16_t len);
int usb_cdc_receive_data(uint8_t *buffer, uint16_t max_len);

/* CRC calculation for packet framing */
uint16_t calculate_crc16(const uint8_t *data, uint16_t len);

/* Get UART device for external use */
const struct device *usb_cdc_get_uart_device(void);

#endif /* USB_CDC_H */ 
```
